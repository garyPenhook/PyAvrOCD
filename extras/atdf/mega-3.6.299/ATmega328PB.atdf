# ATmega328PB device description
Architecture: AVR8; Family: megaAVR
Programming and debug interfaces: ISP, HVPP, debugWIRE
Registers are 8-bit, access not given, no defined reset value unless marked. A register's access mark holds for its fields unless they carry their own. Offsets are from the block's base; lines under a group give offsets from that group; [hi:lo] are bit positions; {n}, {i} and the like mark numbered series; 'fields as' and 'values as' point back to an identical list; <NAME> marks a mode.

## Ordering variants
ATmega328PB-AU: TQFP32, up to 20 MHz, -40 to 85 C, 1.8 to 5.5 V
ATmega328PB-MU: VQFN32, up to 20 MHz, -40 to 85 C, 1.8 to 5.5 V
ATmega328PB-AN: TQFP32, up to 20 MHz, -40 to 105 C, 1.8 to 5.5 V
ATmega328PB-MN: VQFN32, up to 20 MHz, -40 to 105 C, 1.8 to 5.5 V

## Memory
prog space: start 0x0000 size 0x8000, little endian
  0x0000 FLASH size 0x8000 flash, rw, executable, page 0x80
  0x7e00 BOOT_SECTION_1 size 0x0200 flash, rw, executable, page 0x80
  0x7c00 BOOT_SECTION_2 size 0x0400 flash, rw, executable, page 0x80
  0x7800 BOOT_SECTION_3 size 0x0800 flash, rw, executable, page 0x80
  0x7000 BOOT_SECTION_4 size 0x1000 flash, rw, executable, page 0x80
signatures space: start 0 size 3, little endian
  0 SIGNATURES size 3 signatures, ro
fuses space: start 0 size 0x0003, little endian
  0 FUSES size 0x0003 fuses, rw
lockbits space: start 0 size 0x0001, little endian
  0 LOCKBITS size 0x0001 lockbits, rw
data space: start 0x0000 size 0x0900, little endian
  0x0000 REGISTERS size 0x0020 regs
  0x0020 MAPPED_IO size 0x00e0 io
  0x0100 IRAM size 0x0800 ram
eeprom space: start 0x0000 size 0x0400, little endian
  0x0000 EEPROM size 0x0400 eeprom, rw, page 0x04
io space: start 0x00 size 0x40, little endian
osccal space: start 0 size 1, little endian
  0 OSCCAL size 1 osccal, ro

## Peripheral instances (address, pins/pin function, parameters)
USART0 at 0x00
  pins: TXD PD1; RXD PD0; XCK PD4
USART1 at 0x00
  pins: TXD PB3; RXD PB4; XCK PB5
TWI0 at 0x00
  pins: SDA PC4; SCL PC5
TWI1 at 0x00
  pins: SDA PE0; SCL PE1
TC1 at 0x00
  pins: T PD5; ICP PB0; OCA PB1; OCB PB2
TC3 at 0x00
  pins: T PE3; ICP PE2; OCA PD0; OCB PD2
TC4 at 0x00
  pins: T PE1; ICP PE0; OCA PD1; OCB PD2
TC2 at 0x00
  pins: OCA PB3; OCB PD3; TOSC1 PB6; TOSC2 PB7
ADC at 0x00
  pins: ADC0 PC0; ADC1 PC1; ADC2 PC2; ADC3 PC3; ADC4 PC4; ADC5 PC5; ADC6 PE2; ADC7 PE3
AC at 0x00
  pins: AC PE0; AIN0 PD6; AIN1 PD7
PORTB at 0x00 — I/O Port
  pins: P{n} PB{n} (n=0..7)
PORTC at 0x00 — I/O Port
  pins: P0 PC0; P1 PC1; P2 PC2; P3 PC3; P4 PC4; P5 PC5; P6 PC6
PORTD at 0x00 — I/O Port
  pins: P{n} PD{n} (n=0..7)
PORTE at 0x00 — I/O Port
  pins: P0 PE0; P1 PE1; P2 PE2; P3 PE3
TC0 at 0x00
  pins: T PD4; OCB PD5; OCA PD6
EXINT at 0x00
  pins: INT1 PD3; PCINT{n} PD{n-16} (n=16..23); PCINT24 PE0; PCINT25 PE1; PCINT{n} PB{n} (n=0..7); PCINT27 PE2; PCINT8 PC0; PCINT9 PC1; PCINT10 PC2; PCINT11 PC3; PCINT12 PC4; PCINT13 PC5; PCINT14 PC6; INT0 PD2
SPI0 at 0x00
  pins: SS PB2; MOSI PB3; MISO PB4; SCK PB5
SPI1 at 0x00
  pins: SS PE2; SCK PC1; MISO PC0; MOSI PE3
WDT at 0x00
PTC
  pins: X{n:02} PD{n} (n=0..7); X08 PE0; X09 PE1; X10 PB0; X11 PB1; X12 PB2; X13 PB3; X14 PB4; X15 PB5; Y00 PC0; Y01 PC1; Y02 PC2; Y03 PC3; Y04 PC4; Y05 PC5; Y06 PE2; Y07 PE3; Y{n:02} PD{n-8} (n=8..15); Y16 PE0; Y17 PE1; Y18 PB0; Y19 PB1; Y20 PB2; Y21 PB3; Y22 PB4; Y23 PB5
CPU at 0x00
  pins: CLK0 PB0; XTAL1 PB6; XTAL2 PB7
  parameters: CORE_VERSION=V2E
EEPROM at 0x00
FUSE at 0 in fuses
LOCKBIT at 0 in lockbits
CFD at 0x00

## Interrupts
0 RESET — External Pin, Power-on Reset, Brown-out Reset and Watchdog Reset
1 INT0 — External Interrupt Request 0
2 INT1 — External Interrupt Request 1
3 PCINT0 — Pin Change Interrupt Request 0
4 PCINT1 — Pin Change Interrupt Request 1
5 PCINT2 — Pin Change Interrupt Request 2
6 WDT — Watchdog Time-out Interrupt
7 TIMER2_COMPA — Timer/Counter2 Compare Match A
8 TIMER2_COMPB — Timer/Counter2 Compare Match B
9 TIMER2_OVF — Timer/Counter2 Overflow
10 TIMER1_CAPT — Timer/Counter1 Capture Event
11 TIMER1_COMPA — Timer/Counter1 Compare Match A
12 TIMER1_COMPB — Timer/Counter1 Compare Match B
13 TIMER1_OVF — Timer/Counter1 Overflow
14 TIMER0_COMPA — TimerCounter0 Compare Match A
15 TIMER0_COMPB — TimerCounter0 Compare Match B
16 TIMER0_OVF — Timer/Counter0 Overflow
17 SPI0_STC — SPI Serial Transfer Complete
18 USART0_RX — USART0 Rx Complete
19 USART0_UDRE — USART0, Data Register Empty
20 USART0_TX — USART0 Tx Complete
21 ADC — ADC Conversion Complete
22 EE_READY — EEPROM Ready
23 ANALOG_COMP — Analog Comparator
24 TWI0 — Two-wire Serial Interface
25 SPM_Ready — Store Program Memory Read
26 USART0_START — USART0 Start frame detection
27 PCINT3 — Pin Change Interrupt Request 3
28 USART1_RX — USART1 Rx Complete
29 USART1_UDRE — USART1, Data Register Empty
30 USART1_TX — USART1 Tx Complete
31 USART1_START — USART1 Start frame detection
32 TIMER3_CAPT — Timer/Counter3 Capture Event
33 TIMER3_COMPA — Timer/Counter3 Compare Match A
34 TIMER3_COMPB — Timer/Counter3 Compare Match B
35 TIMER3_OVF — Timer/Counter3 Overflow
36 CFD — Clock failure detection interrupt
37 PTC_EOC — PTC End of conversion
38 PTC_WCOMP — PTC Window comparator mode
39 SPI1_STC — SPI1 Serial Transfer Complete
40 TWI1 — TWI Transfer Complete
41 TIMER4_CAPT — Timer/Counter4 Capture Event
42 TIMER4_COMPA — Timer/Counter4 Compare Match A
43 TIMER4_COMPB — Timer/Counter4 Compare Match B
44 TIMER4_OVF — Timer/Counter4 Overflow

## Properties
SIGNATURES: JTAGID=0x9516, SIGNATURE0=0x1e, SIGNATURE1=0x95, SIGNATURE2=0x16
OCD: OCD_REVISION=1, OCD_DATAREG=0x31, PROGBASE=0x0000

## Pinouts (pin number, pad)
TQFP32, VQFN32: 1 PD3, 2 PD4, 3 PE0, 4 VCC, 5 GND, 6 PE1, 7 PB6, 8 PB7, 9 PD5, 10 PD6, 11 PD7, 12 PB0, 13 PB1, 14 PB2, 15 PB3, 16 PB4, 17 PB5, 18 AVCC, 19 PE2, 20 AREF, 21 GND, 22 PE3, 23 PC0, 24 PC1, 25 PC2, 26 PC3, 27 PC4, 28 PC5, 29 PC6, 30 PD0, 31 PD1, 32 PD2
