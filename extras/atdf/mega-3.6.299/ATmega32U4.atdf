# ATmega32U4 device description
Architecture: AVR8; Family: megaAVR
Programming and debug interfaces: ISP, HVPP, JTAG
Registers are 8-bit, access not given, no defined reset value unless marked. A register's access mark holds for its fields unless they carry their own. Offsets are from the block's base; lines under a group give offsets from that group; [hi:lo] are bit positions; {n}, {i} and the like mark numbered series; 'fields as' and 'values as' point back to an identical list; <NAME> marks a mode.

## Ordering variants
ATmega32U4-AU, ATmega32U4RC-AU: TQFP44, up to 16 MHz, -40 to 85 C, 2.7 to 5.5 V
ATmega32U4-MU, ATmega32U4RC-MU: QFN44, up to 16 MHz, -40 to 85 C, 2.7 to 5.5 V

## Memory
prog space: start 0x0000 size 0x8000, little endian
  0x0000 FLASH size 0x8000 flash, rw, executable, page 0x80
  0x7e00 BOOT_SECTION_1 size 0x0200 flash, rw, executable, page 0x80
  0x7c00 BOOT_SECTION_2 size 0x0400 flash, rw, executable, page 0x80
  0x7800 BOOT_SECTION_3 size 0x0800 flash, rw, executable, page 0x80
  0x7000 BOOT_SECTION_4 size 0x1000 flash, rw, executable, page 0x80
signatures space: start 0 size 3, little endian
  0 SIGNATURES size 3 signatures, ro
fuses space: start 0 size 0x0003, little endian
  0 FUSES size 0x0003 fuses, rw
lockbits space: start 0 size 0x0001, little endian
  0 LOCKBITS size 0x0001 lockbits, rw
data space: start 0x0000 size 0x0b00, little endian
  0x0000 REGISTERS size 0x0020 regs
  0x0020 MAPPED_IO size 0x00e0 io
  0x0100 IRAM size 0x0a00 ram
eeprom space: start 0x0000 size 0x0400, little endian
  0x0000 EEPROM size 0x0400 eeprom, rw, page 0x04
io space: start 0x00 size 0x40, little endian
osccal space: start 0 size 1, little endian
  0 OSCCAL size 1 osccal, ro

## Peripheral instances (address, pins/pin function, parameters)
WDT at 0x00 — Watchdog Timer
PORTB at 0x00 — I/O Port
  pins: P{n} PB{n} (n=0..7)
PORTC at 0x00 — I/O Port
  pins: P6 PC6; P7 PC7
PORTD at 0x00 — I/O Port
  pins: P{n} PD{n} (n=0..7)
PORTE at 0x00 — I/O Port
  pins: P2 PE2; P6 PE6
PORTF at 0x00 — I/O Port
  pins: P0 PF0; P1 PF1; P4 PF4; P5 PF5; P6 PF6; P7 PF7
SPI at 0x00 — Serial Peripheral Interface
  pins: SS PB0; SCK PB1; MOSI PB2; PDI PB2; MISO PB3; PDO PB3
USART1 at 0x00 — USART
  pins: TXD PD3; RXD PD2; XCK PD5; RTS PB7; CTS PD5
BOOT_LOAD at 0x00 — Bootloader
  pins: HWB PE2
EEPROM at 0x00
TC0 at 0x00 — Timer/Counter, 8-bit
  pins: T PD7; OCB PD0; OCA PB7
TC1 at 0x00 — Timer/Counter, 16-bit
  pins: T PD6; ICP PD4; OCA PB5; OCB PB6; OCC PB7
TC3 at 0x00 — Timer/Counter, 16-bit
  pins: ICP PC7; OCA PC6
TC4 at 0x00 — Timer/Counter, 10-bit
  pins: _OCA PC6; OCA PC7; _OCB PB5; OCB PB6; _OCD PD6; OCD PD7
JTAG at 0x00 — JTAG Interface
  pins: TCK PF4; TMS PF5; TDO PF6; TDI PF7
EXINT at 0x00 — External Interrupts
  pins: PCINT{n} PB{n} (n=0..7); INT0 PD0; INT1 PD1; INT2 PD2; INT3 PD3; INT6 PE6
TWI at 0x00 — Two Wire Serial Interface
  pins: SDA PD1; SCL PD0
ADC at 0x00 — Analog-to-Digital Converter
  pins: ADC0 PF0; ADC1 PF1; ADC4 PF4; ADC5 PF5; ADC6 PF6; ADC7 PF7; ADC8 PD4; ADC9 PD6; ADC10 PD7; ADC11 PB4; ADC12 PB5; ADC13 PB6
AC at 0x00 — Analog Comparator
  pins: AIN0 PE6
CPU at 0x00 — CPU Registers
  pins: CLK0 PC7
  parameters: CORE_VERSION=V3
PLL at 0x00 — Phase Locked Loop
USB_DEVICE at 0x00 — USB Device Registers
FUSE at 0 in fuses — Fuses
LOCKBIT at 0 in lockbits — Lockbits

## Interrupts
0 RESET — External Pin,Power-on Reset,Brown-out Reset,Watchdog Reset,and JTAG AVR Reset. See Datasheet.
1 INT0 — External Interrupt Request 0
2 INT1 — External Interrupt Request 1
3 INT2 — External Interrupt Request 2
4 INT3 — External Interrupt Request 3
5 Reserved1
6 Reserved2
7 INT6 — External Interrupt Request 6
8 Reserved3
9 PCINT0 — Pin Change Interrupt Request 0
10 USB_GEN — USB General Interrupt Request
11 USB_COM — USB Endpoint/Pipe Interrupt Communication Request
12 WDT — Watchdog Time-out Interrupt
13 Reserved4
14 Reserved5
15 Reserved6
16 TIMER1_CAPT — Timer/Counter1 Capture Event
17 TIMER1_COMPA — Timer/Counter1 Compare Match A
18 TIMER1_COMPB — Timer/Counter1 Compare Match B
19 TIMER1_COMPC — Timer/Counter1 Compare Match C
20 TIMER1_OVF — Timer/Counter1 Overflow
21 TIMER0_COMPA — Timer/Counter0 Compare Match A
22 TIMER0_COMPB — Timer/Counter0 Compare Match B
23 TIMER0_OVF — Timer/Counter0 Overflow
24 SPI_STC — SPI Serial Transfer Complete
25 USART1_RX — USART1, Rx Complete
26 USART1_UDRE — USART1 Data register Empty
27 USART1_TX — USART1, Tx Complete
28 ANALOG_COMP — Analog Comparator
29 ADC — ADC Conversion Complete
30 EE_READY — EEPROM Ready
31 TIMER3_CAPT — Timer/Counter3 Capture Event
32 TIMER3_COMPA — Timer/Counter3 Compare Match A
33 TIMER3_COMPB — Timer/Counter3 Compare Match B
34 TIMER3_COMPC — Timer/Counter3 Compare Match C
35 TIMER3_OVF — Timer/Counter3 Overflow
36 TWI — 2-wire Serial Interface
37 SPM_READY — Store Program Memory Read
38 TIMER4_COMPA — Timer/Counter4 Compare Match A
39 TIMER4_COMPB — Timer/Counter4 Compare Match B
40 TIMER4_COMPD — Timer/Counter4 Compare Match D
41 TIMER4_OVF — Timer/Counter4 Overflow
42 TIMER4_FPF — Timer/Counter4 Fault Protection Interrupt

## Properties
SIGNATURES: JTAGID=0x0958703F, SIGNATURE0=0x1e, SIGNATURE1=0x95, SIGNATURE2=0x87
OCD: OCD_REVISION=3, OCD_DATAREG=0x31, PROGBASE=0x0000

## Pinouts (pin number, pad)
TQFP44, QFN44: 1 PE6, 2 UVCC, 3 DM, 4 DP, 5 UGND, 6 UCAP, 7 VBUS, 8 PB0, 9 PB1, 10 PB2, 11 PB3, 12 PB7, 13 RESET, 14 VCC, 15 GND, 16 XTAL2, 17 XTAL1, 18 PD0, 19 PD1, 20 PD2, 21 PD3, 22 PD5, 23 GND, 24 AVCC, 25 PD4, 26 PD6, 27 PD7, 28 PB4, 29 PB5, 30 PB6, 31 PC6, 32 PC7, 33 PE2, 34 VCC, 35 GND, 36 PF7, 37 PF6, 38 PF5, 39 PF4, 40 PF1, 41 PF0, 42 AREF, 43 GND, 44 AVCC
