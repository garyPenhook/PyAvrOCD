# ATmegaS64M1 device description
Architecture: AVR8; Family: megaAVR
Programming and debug interfaces: ISP, HVPP, debugWIRE
Registers are 8-bit, access not given, no defined reset value unless marked. A register's access mark holds for its fields unless they carry their own. Offsets are from the block's base; lines under a group give offsets from that group; [hi:lo] are bit positions; {n}, {i} and the like mark numbered series; 'fields as' and 'values as' point back to an identical list; <NAME> marks a mode.

## Ordering variants
ATmegaS64M1-KH-E, ATmegaS64M1-KH-MQ, ATmegaS64M1-KH-SV: CQFP32, pinout CQFP32TQFP32, up to 8 MHz, -55 to 125 C, 3.0 to 3.6 V
ATmegaS64M1-MA-HP: TQFP32, pinout CQFP32TQFP32, up to 8 MHz, -55 to 125 C, 3.0 to 3.6 V

## Memory
prog space: start 0x0000 size 0x10000, little endian
  0x0000 FLASH size 0x10000 flash, rw, executable, page 0x100
  0xfc00 BOOT_SECTION_1 size 0x0400 flash, rw, executable, page 0x100
  0xf800 BOOT_SECTION_2 size 0x0800 flash, rw, executable, page 0x100
  0xf000 BOOT_SECTION_3 size 0x1000 flash, rw, executable, page 0x100
  0xe000 BOOT_SECTION_4 size 0x2000 flash, rw, executable, page 0x100
signatures space: start 0 size 3, little endian
  0 SIGNATURES size 3 signatures, ro
fuses space: start 0 size 0x0003, little endian
  0 FUSES size 0x0003 fuses, rw
lockbits space: start 0 size 0x0001, little endian
  0 LOCKBITS size 0x0001 lockbits, rw
data space: start 0x0000 size 0x1100, little endian
  0x0000 REGISTERS size 0x0020 regs
  0x0020 MAPPED_IO size 0x00e0 io
  0x0100 IRAM size 0x1000 ram
eeprom space: start 0x0000 size 0x0800, little endian
  0x0000 EEPROM size 0x0800 eeprom, rw, page 0x08
io space: start 0x00 size 0x40, little endian
osccal space: start 0 size 1, little endian
  0 OSCCAL size 1 osccal, ro

## Peripheral instances (address, pins/pin function, parameters)
PORTB at 0x00 — I/O Port
  pins: PIN{n} PB{n}/IOPORT (n=0..7)
PORTC at 0x00 — I/O Port
  pins: PIN{n} PC{n}/IOPORT (n=0..7)
PORTD at 0x00 — I/O Port
  pins: PIN{n} PD{n}/IOPORT (n=0..7)
PORTE at 0x00 — I/O Port
  pins: PIN0 PE0/IOPORT; PIN1 PE1/IOPORT; PIN2 PE2/IOPORT
CAN at 0x00 — Controller Area Network
AC at 0x00 — Analog Comparator
  pins: ACMP0 PD7; ACMP1 PC6; ACMP2 PD5; ACMP3 PC5; ACMPN0 PB2; ACMPN1 PB5; ACMPN2 PD6; ACMPN3 PC4
DAC at 0x00 — Digital-to-Analog Converter
  pins: D2A PC7
CPU at 0x00 — CPU Registers
  parameters: CORE_VERSION=V2E
TC0 at 0x00 — Timer/Counter, 8-bit
  pins: T0 PC2; OC0A PD3; OC0B PE1
TC1 at 0x00 — Timer/Counter, 16-bit
  pins: T1 PC3; ICP1A PD4; ICP1B PC3; OC1A PD2; OC1B PC1
ADC at 0x00 — Analog-to-Digital Converter
  pins: ADC0 PE2; ADC1 PD4; ADC2 PD5; ADC3 PD6; ADC4 PB7; ADC5 PB2; ADC6 PB5; ADC7 PB6; ADC8 PC4; ADC9 PC5; ADC10 PC6
LINUART at 0x00 — Local Interconnect Network
  pins: TXLIN PD3/LIN; RXLIN PD4/LIN
SPI at 0x00 — Serial Peripheral Interface
  pins: MISO PB0 or PD2/SPI_ALT; MOSI PB1 or PD3/SPI_ALT; SCK PB7 or PD4/SPI_ALT; SS PD3 or PC1/SPI_ALT
WDT at 0x00 — Watchdog Timer
EXINT at 0x00 — External Interrupts
  pins: INT0 PD6; INT1 PB2; INT2 PB5; INT3 PC0; PCINT{n} PB{n} (n=0..7); PCINT{n} PC{n-8} (n=8..15); PCINT{n} PD{n-16} (n=16..23); PCINT24 PE0; PCINT25 PE1; PCINT26 PE2
EEPROM at 0x00
PSC at 0x00 — Power Stage Controller
  pins: PSCIN2 PD2; PSCOUT2A PB0; PSCOUT2B PB1; PSCIN1 PC1; PSCOUT1A PC0; PSCOUT1B PB6; PSCIN0 PD1; PSCOUT0A PD0; PSCOUT0B PB7
FUSE at 0 in fuses — Fuses
LOCKBIT at 0 in lockbits — Lockbits

## Interrupts
0 RESET — External Pin, Power-on Reset, Brown-out Reset, Watchdog Reset and JTAG AVR Reset
1 ANACOMP0 — Analog Comparator 0
2 ANACOMP1 — Analog Comparator 1
3 ANACOMP2 — Analog Comparator 2
4 ANACOMP3 — Analog Comparator 3
5 PSC_FAULT
6 PSC_EC — PSC End of Cycle
7 INT0 — External Interrupt Request 0
8 INT1 — External Interrupt Request 1
9 INT2 — External Interrupt Request 2
10 INT3 — External Interrupt Request 3
11 TIMER1_CAPT — Timer/Counter1 Capture Event
12 TIMER1_COMPA — Timer/Counter1 Compare Match A
13 TIMER1_COMPB — Timer/Counter1 Compare Match B
14 TIMER1_OVF — Timer1/Counter1 Overflow
15 TIMER0_COMPA — Timer/Counter0 Compare Match A
16 TIMER0_COMPB — Timer/Counter0 Compare Match B
17 TIMER0_OVF — Timer/Counter0 Overflow
18 CAN_INT — CAN MOB, Burst, General Errors
19 CAN_TOVF — CAN Timer Overflow
20 LIN_TC — LIN Transfer Complete
21 LIN_ERR — LIN Error
22 PCINT0 — Pin Change Interrupt Request 0
23 PCINT1 — Pin Change Interrupt Request 1
24 PCINT2 — Pin Change Interrupt Request 2
25 PCINT3 — Pin Change Interrupt Request 3
26 SPI_STC — SPI Serial Transfer Complete
27 ADC — ADC Conversion Complete
28 WDT — Watchdog Time-Out Interrupt
29 EE_READY — EEPROM Ready
30 SPM_READY — Store Program Memory Read

## Properties
SIGNATURES: JTAGID=0x9684, SIGNATURE0=0x1e, SIGNATURE1=0x96, SIGNATURE2=0x84
OCD: OCD_REVISION=1, OCD_DATAREG=0x31, PROGBASE=0x0000

## Pinouts (pin number, pad)
CQFP32TQFP32: 1 PD2, 2 PD3, 3 PC1, 4 VCC, 5 GND, 6 PC2, 7 PC3, 8 PB0, 9 PB1, 10 PE1, 11 PE2, 12 PD4, 13 PD5, 14 PD6, 15 PD7, 16 PB2, 17 PC4, 18 PC5, 19 AVCC, 20 AGND, 21 AREF, 22 PC6, 23 PB3, 24 PB4, 25 PC7, 26 PB5, 27 PB6, 28 PB7, 29 PD0, 30 PC0, 31 PE0, 32 PD1
