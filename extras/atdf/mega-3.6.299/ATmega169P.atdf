# ATmega169P device description
Architecture: AVR8; Family: megaAVR
Programming and debug interfaces: ISP, HVPP, JTAG
Registers are 8-bit, access not given, no defined reset value unless marked. A register's access mark holds for its fields unless they carry their own. Offsets are from the block's base; lines under a group give offsets from that group; [hi:lo] are bit positions; {n}, {i} and the like mark numbered series; 'fields as' and 'values as' point back to an identical list; <NAME> marks a mode.

## Ordering variants
ATmega169PV-8AU: TQFP64, up to 8 MHz, -40 to 85 C, 1.8 to 5.5 V
ATmega169PV-8MU: QFN64, up to 8 MHz, -40 to 85 C, 1.8 to 5.5 V
ATmega169PV-8MCH: DRQFN64, up to 8 MHz, -40 to 85 C, 1.8 to 5.5 V
ATmega169P-16AU: TQFP64, up to 16 MHz, -40 to 85 C, 2.7 to 5.5 V
ATmega169P-16MU: QFN64, up to 16 MHz, -40 to 85 C, 2.7 to 5.5 V
ATmega169P-16MCH: DRQFN64, up to 16 MHz, -40 to 85 C, 2.7 to 5.5 V

## Memory
prog space: start 0x0000 size 0x4000, little endian
  0x0000 FLASH size 0x4000 flash, rw, executable, page 0x80
  0x3f00 BOOT_SECTION_1 size 0x0100 flash, rw, executable, page 0x80
  0x3e00 BOOT_SECTION_2 size 0x0200 flash, rw, executable, page 0x80
  0x3c00 BOOT_SECTION_3 size 0x0400 flash, rw, executable, page 0x80
  0x3800 BOOT_SECTION_4 size 0x0800 flash, rw, executable, page 0x80
signatures space: start 0 size 3, little endian
  0 SIGNATURES size 3 signatures, ro
fuses space: start 0 size 0x0003, little endian
  0 FUSES size 0x0003 fuses, rw
lockbits space: start 0 size 0x0001, little endian
  0 LOCKBITS size 0x0001 lockbits, rw
data space: start 0x0000 size 0x0500, little endian
  0x0000 REGISTERS size 0x0020 regs
  0x0020 MAPPED_IO size 0x00e0 io
  0x0100 IRAM size 0x0400 ram
eeprom space: start 0x0000 size 0x0200, little endian
  0x0000 EEPROM size 0x0200 eeprom, rw, page 0x04
io space: start 0x00 size 0x40, little endian
osccal space: start 0 size 1, little endian
  0 OSCCAL size 1 osccal, ro

## Peripheral instances (address, pins/pin function, parameters)
TC0 at 0x00 — Timer/Counter, 8-bit
  pins: T PG4; OCA PB4
TC1 at 0x00 — Timer/Counter, 16-bit
  pins: T PG3; ICP PD0; OCA PB5; OCB PB6; TOSC XTAL1
TC2 at 0x00 — Timer/Counter, 8-bit Async
  pins: OCA PB7; TOSC XTAL2
WDT at 0x00 — Watchdog Timer
EEPROM at 0x00
SPI at 0x00 — Serial Peripheral Interface
  pins: SS PB0; SCK PB1; MOSI PB2; MISO PB3
PORTA at 0x00 — I/O Port
  pins: P{n} PA{n} (n=0..7)
PORTB at 0x00 — I/O Port
  pins: P{n} PB{n} (n=0..7)
PORTC at 0x00 — I/O Port
  pins: P{n} PC{n} (n=0..7)
PORTD at 0x00 — I/O Port
  pins: P{n} PD{n} (n=0..7)
PORTE at 0x00 — I/O Port
  pins: P{n} PE{n} (n=0..7)
PORTF at 0x00 — I/O Port
  pins: P{n} PF{n} (n=0..7)
PORTG at 0x00 — I/O Port
  pins: P0 PG0; P1 PG1; P2 PG2; P3 PG3; P4 PG4; P5 PG5
AC at 0x00 — Analog Comparator
  pins: AIN0 PE2; AIN1 PE3
JTAG at 0x00 — JTAG Interface
  pins: TCK PF4; TMS PF5; TDO PF6; TDI PF7
LCD at 0x00 — Liquid Crystal Display
  pins: SEG0 PA4; SEG1 PA5; SEG2 PA6; SEG3 PA7; SEG4 PG2; SEG5 PC7; SEG6 PC6; SEG7 PC5; SEG8 PC4; SEG9 PC3; SEG10 PC2; SEG11 PC1; SEG12 PC0; SEG13 PG1; SEG14 PG2; SEG15 PD7; SEG16 PD6; SEG17 PD5; SEG18 PD4; SEG19 PD3; SEG20 PD2; SEG21 PD1; SEG22 PD0; SEG23 PG4; SEG24 PG3; COM0 PA0; COM1 PA1; COM2 PA2; COM3 PA3
EXINT at 0x00 — External Interrupts
  pins: PCINT{n} PE{n} (n=0..7); PCINT{n} PB{n-8} (n=8..15); INT0 PD1
CPU at 0x00 — CPU Registers
  pins: CLK0 PE7
  parameters: CORE_VERSION=V2E
USI at 0x00 — Universal Serial Interface
  pins: DI PE5; DO PE6
ADC at 0x00 — Analog-to-Digital Converter
  pins: ADC{n} PF{n} (n=0..7)
BOOT_LOAD at 0x00 — Bootloader
USART0 at 0x00 — USART
  pins: RXD PE0; TXD PE1; XCK PE2; USCK PE4
FUSE at 0 in fuses — Fuses
LOCKBIT at 0 in lockbits — Lockbits

## Interrupts
0 RESET — External Pin,Power-on Reset,Brown-out Reset,Watchdog Reset,and JTAG AVR Reset. See Datasheet.
1 INT0 — External Interrupt Request 0
2 PCINT0 — Pin Change Interrupt Request 0
3 PCINT1 — Pin Change Interrupt Request 1
4 TIMER2_COMP — Timer/Counter2 Compare Match
5 TIMER2_OVF — Timer/Counter2 Overflow
6 TIMER1_CAPT — Timer/Counter1 Capture Event
7 TIMER1_COMPA — Timer/Counter1 Compare Match A
8 TIMER1_COMPB — Timer/Counter Compare Match B
9 TIMER1_OVF — Timer/Counter1 Overflow
10 TIMER0_COMP — Timer/Counter0 Compare Match
11 TIMER0_OVF — Timer/Counter0 Overflow
12 SPI_STC — SPI Serial Transfer Complete
13 USART0_RX — USART0, Rx Complete
14 USART0_UDRE — USART0 Data register Empty
15 USART0_TX — USART0, Tx Complete
16 USI_START — USI Start Condition
17 USI_OVERFLOW
18 ANALOG_COMP — Analog Comparator
19 ADC — ADC Conversion Complete
20 EE_READY — EEPROM Ready
21 SPM_READY — Store Program Memory Read
22 LCD — LCD Start of Frame

## Properties
SIGNATURES: JTAGID=0x0940503F, SIGNATURE0=0x1e, SIGNATURE1=0x94, SIGNATURE2=0x05
OCD: OCD_REVISION=2, OCD_DATAREG=0x31, PROGBASE=0x0000

## Pinouts (pin number, pad)
TQFP64, QFN64: 1 LCDCAP, 2 PE0, 3 PE1, 4 PE2, 5 PE3, 6 PE4, 7 PE5, 8 PE6, 9 PE7, 10 PB0, 11 PB1, 12 PB2, 13 PB3, 14 PB4, 15 PB5, 16 PB6, 17 PB7, 18 PG3, 19 PG4, 20 PG5, 21 VCC, 22 GND, 23 XTAL2, 24 XTAL1, 25 PD0, 26 PD1, 27 PD2, 28 PD3, 29 PD4, 30 PD5, 31 PD6, 32 PD7, 33 PG0, 34 PG1, 35 PC0, 36 PC1, 37 PC2, 38 PC3, 39 PC4, 40 PC5, 41 PC6, 42 PC7, 43 PG2, 44 PA7, 45 PA6, 46 PA5, 47 PA4, 48 PA3, 49 PA2, 50 PA1, 51 PA0, 52 VCC, 53 GND, 54 PF7, 55 PF6, 56 PF5, 57 PF4, 58 PF3, 59 PF2, 60 PF1, 61 PF0, 62 AREF, 63 GND, 64 AVCC
DRQFN64: B1 LCDCAP, A1 PE0, A2 PE1, B2 PE2, A3 PE3, B3 PE4, A4 PE5, B4 PE6, A5 PE7, B5 PB0, A6 PB1, B6 PB2, A7 PB3, A8 PB4, B7 PB5, B8 PB6, A9 PB7, A10 PG3, B9 PG4, A11 PG5, B10 VCC, A12 GND, B11 XTAL2, A13 XTAL1, B12 PD0, A14 PD1, B13 PD2, A15 PD3, B14 PD4, A16 PD5, A17 PD6, B15 PD7, B16 PG0, A18 PG1, A19 PC0, B17 PC1, A20 PC2, B18 PC3, A21 PC4, B19 PC5, A22 PC6, B20 PC7, A23 PG2, B21 PA7, A24 PA6, A25 PA5, B22 PA4, B23 PA3, A26 PA2, A27 PA1, B24 PA0, A28 VCC, B25 GND, A29 PF7, B26 PF6, A30 PF5, B27 PF4, A31 PF3, B28 PF2, A32 PF1, B29 PF0, A33 AREF, A34 GND, B30 AVCC
