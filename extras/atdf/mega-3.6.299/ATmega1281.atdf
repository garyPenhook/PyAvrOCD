# ATmega1281 device description
Architecture: AVR8; Family: megaAVR
Programming and debug interfaces: ISP, HVPP, JTAG
Registers are 8-bit, access not given, no defined reset value unless marked. A register's access mark holds for its fields unless they carry their own. Offsets are from the block's base; lines under a group give offsets from that group; [hi:lo] are bit positions; {n}, {i} and the like mark numbered series; 'fields as' and 'values as' point back to an identical list; <NAME> marks a mode.

## Ordering variants
ATmega1281V-8AU: TQFP64, up to 8 MHz, -40 to 85 C, 1.8 to 5.5 V
ATmega1281V-8MU: QFN64, up to 8 MHz, -40 to 85 C, 1.8 to 5.5 V
ATmega1281-16AU: TQFP64, up to 16 MHz, -40 to 85 C, 2.7 to 5.5 V
ATmega1281-16MU: QFN64, up to 16 MHz, -40 to 85 C, 2.7 to 5.5 V

## Memory
prog space: start 0x0000 size 0x20000, little endian
  0x0000 FLASH size 0x20000 flash, rw, executable, page 0x100
  0x1fc00 BOOT_SECTION_1 size 0x0400 flash, rw, executable, page 0x100
  0x1f800 BOOT_SECTION_2 size 0x0800 flash, rw, executable, page 0x100
  0x1f000 BOOT_SECTION_3 size 0x1000 flash, rw, executable, page 0x100
  0x1e000 BOOT_SECTION_4 size 0x2000 flash, rw, executable, page 0x100
signatures space: start 0 size 3, little endian
  0 SIGNATURES size 3 signatures, ro
fuses space: start 0 size 0x0003, little endian
  0 FUSES size 0x0003 fuses, rw
lockbits space: start 0 size 0x0001, little endian
  0 LOCKBITS size 0x0001 lockbits, rw
data space: start 0x0000 size 0x10000, little endian
  0x0000 REGISTERS size 0x0020 regs
  0x0020 MAPPED_IO size 0x01e0 io
  0x0200 IRAM size 0x2000 ram
  0x2200 XRAM size 0xde00 ram, external
eeprom space: start 0x0000 size 0x1000, little endian
  0x0000 EEPROM size 0x1000 eeprom, rw, page 0x08
io space: start 0x00 size 0x40, little endian
osccal space: start 0 size 1, little endian
  0 OSCCAL size 1 osccal, ro

## Peripheral instances (address, pins/pin function, parameters)
AC at 0x00 — Analog Comparator
  pins: AIN0 PE2; AIN1 PE3
USART0 at 0x00 — USART
  pins: TXD PE1; RXD PE0; XCK PE2
USART1 at 0x00 — USART
  pins: TXD PD3; RXD PD2; XCK PD5
TWI at 0x00 — Two Wire Serial Interface
  pins: SDA PD1; SCL PD0
SPI at 0x00 — Serial Peripheral Interface
  pins: SS PB0; MOSI PB2; MISO PB3; SCK PB1
PORTA at 0x00 — I/O Port
  pins: P{n} PA{n} (n=0..7)
PORTB at 0x00 — I/O Port
  pins: P{n} PB{n} (n=0..7)
PORTC at 0x00 — I/O Port
  pins: P{n} PC{n} (n=0..7)
PORTD at 0x00 — I/O Port
  pins: P{n} PD{n} (n=0..7)
PORTE at 0x00 — I/O Port
  pins: P{n} PE{n} (n=0..7)
PORTF at 0x00 — I/O Port
  pins: P{n} PF{n} (n=0..7)
PORTG at 0x00 — I/O Port
  pins: P0 PG0; P1 PG1; P2 PG2; P3 PG3; P4 PG4; P5 PG5
TC0 at 0x00 — Timer/Counter, 8-bit
  pins: T PD7; OCB PG5; OCA PB7
TC2 at 0x00 — Timer/Counter, 8-bit Async
  pins: TOSC1 PG4; TOSC2 PG3; OCA PB4
WDT at 0x00 — Watchdog Timer
TC5 at 0x00 — Timer/Counter, 16-bit
TC4 at 0x00 — Timer/Counter, 16-bit
TC3 at 0x00 — Timer/Counter, 16-bit
  pins: T PE6; ICP PE7; OCA PE3; OCB PE4; OCC PE5
TC1 at 0x00 — Timer/Counter, 16-bit
  pins: T PD6; ICP PD4; OCA PB5; OCB PB6; OCC PB7
EEPROM at 0x00
JTAG at 0x00 — JTAG Interface
  pins: TCK PF4; TMS PF5; TDO PF6; TDI PF7
EXINT at 0x00 — External Interrupts
  pins: PCINT{n} PB{n} (n=0..7); PCINT8 PE0; INT0 PD0; INT1 PD1; INT2 PD2; INT3 PD3; INT4 PE4; INT5 PE5; INT6 PE6; INT7 PE7
ADC at 0x00 — Analog-to-Digital Converter
  pins: ADC{n} PF{n} (n=0..7)
BOOT_LOAD at 0x00 — Bootloader
CPU at 0x00 — CPU Registers
  pins: CLKO0 PE7
  parameters: CORE_VERSION=V3
FUSE at 0 in fuses — Fuses
LOCKBIT at 0 in lockbits — Lockbits

## Interrupts
0 RESET — External Pin,Power-on Reset,Brown-out Reset,Watchdog Reset,and JTAG AVR Reset. See Datasheet.
{n+1} INT{n} (n=0..7) — External Interrupt Request {n}
9 PCINT0 — Pin Change Interrupt Request 0
10 PCINT1 — Pin Change Interrupt Request 1
11 PCINT2 — Pin Change Interrupt Request 2
12 WDT — Watchdog Time-out Interrupt
13 TIMER2_COMPA — Timer/Counter2 Compare Match A
14 TIMER2_COMPB — Timer/Counter2 Compare Match B
15 TIMER2_OVF — Timer/Counter2 Overflow
16 TIMER1_CAPT — Timer/Counter1 Capture Event
17 TIMER1_COMPA — Timer/Counter1 Compare Match A
18 TIMER1_COMPB — Timer/Counter1 Compare Match B
19 TIMER1_COMPC — Timer/Counter1 Compare Match C
20 TIMER1_OVF — Timer/Counter1 Overflow
21 TIMER0_COMPA — Timer/Counter0 Compare Match A
22 TIMER0_COMPB — Timer/Counter0 Compare Match B
23 TIMER0_OVF — Timer/Counter0 Overflow
24 SPI_STC — SPI Serial Transfer Complete
25 USART0_RX — USART0, Rx Complete
26 USART0_UDRE — USART0 Data register Empty
27 USART0_TX — USART0, Tx Complete
28 ANALOG_COMP — Analog Comparator
29 ADC — ADC Conversion Complete
30 EE_READY — EEPROM Ready
31 TIMER3_CAPT — Timer/Counter3 Capture Event
32 TIMER3_COMPA — Timer/Counter3 Compare Match A
33 TIMER3_COMPB — Timer/Counter3 Compare Match B
34 TIMER3_COMPC — Timer/Counter3 Compare Match C
35 TIMER3_OVF — Timer/Counter3 Overflow
36 USART1_RX — USART1, Rx Complete
37 USART1_UDRE — USART1 Data register Empty
38 USART1_TX — USART1, Tx Complete
39 TWI — 2-wire Serial Interface
40 SPM_READY — Store Program Memory Read
41 TIMER4_CAPT — Timer/Counter4 Capture Event
42 TIMER4_COMPA — Timer/Counter4 Compare Match A
43 TIMER4_COMPB — Timer/Counter4 Compare Match B
44 TIMER4_COMPC — Timer/Counter4 Compare Match C
45 TIMER4_OVF — Timer/Counter4 Overflow
46 TIMER5_CAPT — Timer/Counter5 Capture Event
47 TIMER5_COMPA — Timer/Counter5 Compare Match A
48 TIMER5_COMPB — Timer/Counter5 Compare Match B
49 TIMER5_COMPC — Timer/Counter5 Compare Match C
50 TIMER5_OVF — Timer/Counter5 Overflow
51 USART2_RX — USART2, Rx Complete
52 USART2_UDRE — USART2 Data register Empty
53 USART2_TX — USART2, Tx Complete
54 USART3_RX — USART3, Rx Complete
55 USART3_UDRE — USART3 Data register Empty
56 USART3_TX — USART3, Tx Complete

## Properties
SIGNATURES: JTAGID=0x0970403F, SIGNATURE0=0x1e, SIGNATURE1=0x97, SIGNATURE2=0x04
OCD: OCD_REVISION=3, OCD_DATAREG=0x31, PROGBASE=0x0000

## Pinouts (pin number, pad)
TQFP64, QFN64: 1 PG5, 2 PE0, 3 PE1, 4 PE2, 5 PE3, 6 PE4, 7 PE5, 8 PE6, 9 PE7, 10 PB0, 11 PB1, 12 PB2, 13 PB3, 14 PB4, 15 PB5, 16 PB6, 17 PB7, 18 PG3, 19 PG4, 20 RESET, 21 VCC, 22 GND, 23 XTAL2, 24 XTAL1, 25 PD0, 26 PD1, 27 PD2, 28 PD3, 29 PD4, 30 PD5, 31 PD6, 32 PD7, 33 PG0, 34 PG1, 35 PC0, 36 PC1, 37 PC2, 38 PC3, 39 PC4, 40 PC5, 41 PC6, 42 PC7, 43 PG2, 44 PA7, 45 PA6, 46 PA5, 47 PA4, 48 PA3, 49 PA2, 50 PA1, 51 PA0, 52 VCC, 53 GND, 54 PF7, 55 PF6, 56 PF5, 57 PF4, 58 PF3, 59 PF2, 60 PF1, 61 PF0, 62 AREF, 63 GND, 64 AVCC
