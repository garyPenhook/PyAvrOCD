# ATmega2560 device description
Architecture: AVR8; Family: megaAVR
Programming and debug interfaces: ISP, HVPP, JTAG
Registers are 8-bit, access not given, no defined reset value unless marked. A register's access mark holds for its fields unless they carry their own. Offsets are from the block's base; lines under a group give offsets from that group; [hi:lo] are bit positions; {n}, {i} and the like mark numbered series; 'fields as' and 'values as' point back to an identical list; <NAME> marks a mode.

## Ordering variants
ATmega2560V-8AU: TQFP100, up to 8 MHz, -40 to 85 C, 1.8 to 5.5 V
ATmega2560V-8CU: CBGA100, up to 8 MHz, -40 to 85 C, 1.8 to 5.5 V
ATmega2560-16AU: TQFP100, up to 16 MHz, -40 to 85 C, 4.5 to 5.5 V
ATmega2560-16CU: CBGA100, up to 16 MHz, -40 to 85 C, 4.5 to 5.5 V

## Memory
prog space: start 0x0000 size 0x40000, little endian
  0x0000 FLASH size 0x40000 flash, rw, executable, page 0x100
  0x3fc00 BOOT_SECTION_1 size 0x0400 flash, rw, executable, page 0x100
  0x3f800 BOOT_SECTION_2 size 0x0800 flash, rw, executable, page 0x100
  0x3f000 BOOT_SECTION_3 size 0x1000 flash, rw, executable, page 0x100
  0x3e000 BOOT_SECTION_4 size 0x2000 flash, rw, executable, page 0x100
signatures space: start 0 size 3, little endian
  0 SIGNATURES size 3 signatures, ro
fuses space: start 0 size 0x0003, little endian
  0 FUSES size 0x0003 fuses, rw
lockbits space: start 0 size 0x0001, little endian
  0 LOCKBITS size 0x0001 lockbits, rw
data space: start 0x0000 size 0x10000, little endian
  0x0000 REGISTERS size 0x0020 regs
  0x0020 MAPPED_IO size 0x01e0 io
  0x0200 IRAM size 0x2000 ram
  0x2200 XRAM size 0xde00 ram, external
eeprom space: start 0x0000 size 0x1000, little endian
  0x0000 EEPROM size 0x1000 eeprom, rw, page 0x08
io space: start 0x00 size 0x40, little endian
osccal space: start 0 size 1, little endian
  0 OSCCAL size 1 osccal, ro

## Peripheral instances (address, pins/pin function, parameters)
AC at 0x00 — Analog Comparator
  pins: AIN0 PE2; AIN1 PE3
USART0 at 0x00 — USART
  pins: TXD PE1; RXD PE0; XCK PE2
USART1 at 0x00 — USART
  pins: TXD PD3; RXD PD2; XCK PD5
USART2 at 0x00 — USART
  pins: TXD PH1; RXD PH0; XCK PH2
USART3 at 0x00 — USART
  pins: TXD PJ1; RXD PJ0; XCK PJ2
TWI at 0x00 — Two Wire Serial Interface
  pins: SDA PD1; SCL PD0
SPI at 0x00 — Serial Peripheral Interface
  pins: SS PB0; MOSI PB2; MISO PB3; SCK PB1
PORTA at 0x00 — I/O Port
  pins: P{n} PA{n} (n=0..7)
PORTB at 0x00 — I/O Port
  pins: P{n} PB{n} (n=0..7)
PORTC at 0x00 — I/O Port
  pins: P{n} PC{n} (n=0..7)
PORTD at 0x00 — I/O Port
  pins: P{n} PD{n} (n=0..7)
PORTE at 0x00 — I/O Port
  pins: P{n} PE{n} (n=0..7)
PORTF at 0x00 — I/O Port
  pins: P{n} PF{n} (n=0..7)
PORTG at 0x00 — I/O Port
  pins: P0 PG0; P1 PG1; P2 PG2; P3 PG3; P4 PG4; P5 PG5
PORTH at 0x00 — I/O Port
  pins: P{n} PH{n} (n=0..7)
PORTJ at 0x00 — I/O Port
  pins: P{n} PJ{n} (n=0..7)
PORTK at 0x00 — I/O Port
  pins: P{n} PK{n} (n=0..7)
PORTL at 0x00 — I/O Port
  pins: P{n} PL{n} (n=0..7)
TC0 at 0x00 — Timer/Counter, 8-bit
  pins: T PD7; OCB PG5; OCA PB7
TC2 at 0x00 — Timer/Counter, 8-bit Async
  pins: TOSC1 PG4; TOSC2 PG3; OCA PB4; OCB PH6
WDT at 0x00 — Watchdog Timer
EEPROM at 0x00
TC5 at 0x00 — Timer/Counter, 16-bit
  pins: T PL2; ICP PL1; OCA PL3; OCB PL4; OCC PL5
TC4 at 0x00 — Timer/Counter, 16-bit
  pins: T PBH7; ICP PL0; OCA PH3; OCB PH4; OCC PH5
TC3 at 0x00 — Timer/Counter, 16-bit
  pins: T PE6; ICP PE7; OCA PE3; OCB PE4; OCC PE5
TC1 at 0x00 — Timer/Counter, 16-bit
  pins: T PD6; ICP PD4; OCA PB5; OCB PB6; OCC PB7
JTAG at 0x00 — JTAG Interface
  pins: TCK PF4; TMS PF5; TDO PF6; TDI PF7
EXINT at 0x00 — External Interrupts
  pins: PCINT{n} PB{n} (n=0..7); PCINT8 PE0; PCINT9 PJ0; PCINT10 PJ1; PCINT11 PJ2; PCINT12 PJ3; PCINT13 PJ4; PCINT14 PJ5; PCINT15 PJ6; PCINT{n} PK{n-16} (n=16..23); INT0 PD0; INT1 PD1; INT2 PD2; INT3 PD3; INT4 PE4; INT5 PE5; INT6 PE6; INT7 PE7
CPU at 0x00 — CPU Registers
  pins: CLKO0 PE7
  parameters: CORE_VERSION=V3
ADC at 0x00 — Analog-to-Digital Converter
  pins: ADC{n} PF{n} (n=0..7); ADC{n} PK{n-8} (n=8..15)
BOOT_LOAD at 0x00 — Bootloader
FUSE at 0 in fuses — Fuses
LOCKBIT at 0 in lockbits — Lockbits

## Interrupts
0 RESET — External Pin,Power-on Reset,Brown-out Reset,Watchdog Reset,and JTAG AVR Reset. See Datasheet.
{n+1} INT{n} (n=0..7) — External Interrupt Request {n}
9 PCINT0 — Pin Change Interrupt Request 0
10 PCINT1 — Pin Change Interrupt Request 1
11 PCINT2 — Pin Change Interrupt Request 2
12 WDT — Watchdog Time-out Interrupt
13 TIMER2_COMPA — Timer/Counter2 Compare Match A
14 TIMER2_COMPB — Timer/Counter2 Compare Match B
15 TIMER2_OVF — Timer/Counter2 Overflow
16 TIMER1_CAPT — Timer/Counter1 Capture Event
17 TIMER1_COMPA — Timer/Counter1 Compare Match A
18 TIMER1_COMPB — Timer/Counter1 Compare Match B
19 TIMER1_COMPC — Timer/Counter1 Compare Match C
20 TIMER1_OVF — Timer/Counter1 Overflow
21 TIMER0_COMPA — Timer/Counter0 Compare Match A
22 TIMER0_COMPB — Timer/Counter0 Compare Match B
23 TIMER0_OVF — Timer/Counter0 Overflow
24 SPI_STC — SPI Serial Transfer Complete
25 USART0_RX — USART0, Rx Complete
26 USART0_UDRE — USART0 Data register Empty
27 USART0_TX — USART0, Tx Complete
28 ANALOG_COMP — Analog Comparator
29 ADC — ADC Conversion Complete
30 EE_READY — EEPROM Ready
31 TIMER3_CAPT — Timer/Counter3 Capture Event
32 TIMER3_COMPA — Timer/Counter3 Compare Match A
33 TIMER3_COMPB — Timer/Counter3 Compare Match B
34 TIMER3_COMPC — Timer/Counter3 Compare Match C
35 TIMER3_OVF — Timer/Counter3 Overflow
36 USART1_RX — USART1, Rx Complete
37 USART1_UDRE — USART1 Data register Empty
38 USART1_TX — USART1, Tx Complete
39 TWI — 2-wire Serial Interface
40 SPM_READY — Store Program Memory Read
41 TIMER4_CAPT — Timer/Counter4 Capture Event
42 TIMER4_COMPA — Timer/Counter4 Compare Match A
43 TIMER4_COMPB — Timer/Counter4 Compare Match B
44 TIMER4_COMPC — Timer/Counter4 Compare Match C
45 TIMER4_OVF — Timer/Counter4 Overflow
46 TIMER5_CAPT — Timer/Counter5 Capture Event
47 TIMER5_COMPA — Timer/Counter5 Compare Match A
48 TIMER5_COMPB — Timer/Counter5 Compare Match B
49 TIMER5_COMPC — Timer/Counter5 Compare Match C
50 TIMER5_OVF — Timer/Counter5 Overflow
51 USART2_RX — USART2, Rx Complete
52 USART2_UDRE — USART2 Data register Empty
53 USART2_TX — USART2, Tx Complete
54 USART3_RX — USART3, Rx Complete
55 USART3_UDRE — USART3 Data register Empty
56 USART3_TX — USART3, Tx Complete

## Properties
SIGNATURES: JTAGID=0x0980103F, SIGNATURE0=0x1e, SIGNATURE1=0x98, SIGNATURE2=0x01
OCD: OCD_REVISION=4, OCD_DATAREG=0x31, PROGBASE=0x0000

## Pinouts (pin number, pad)
TQFP100: 1 PG5, 2 PE0, 3 PE1, 4 PE2, 5 PE3, 6 PE4, 7 PE5, 8 PE6, 9 PE7, 10 VCC, 11 GND, 12 PH0, 13 PH1, 14 PH2, 15 PH3, 16 PH4, 17 PH5, 18 PH6, 19 PB0, 20 PB1, 21 PB2, 22 PB3, 23 PB4, 24 PB5, 25 PB6, 26 PB7, 27 PH7, 28 PG3, 29 PG4, 30 RESET, 31 VCC, 32 GND, 33 XTAL2, 34 XTAL1, 35 PL0, 36 PL1, 37 PL2, 38 PL3, 39 PL4, 40 PL5, 41 PL6, 42 PL7, 43 PD0, 44 PD1, 45 PD2, 46 PD3, 47 PD4, 48 PD5, 49 PD6, 50 PD7, 51 PG0, 52 PG1, 53 PC0, 54 PC1, 55 PC2, 56 PC3, 57 PC4, 58 PC5, 59 PC6, 60 PC7, 61 VCC, 62 GND, 63 PJ0, 64 PJ1, 65 PJ2, 66 PJ3, 67 PJ4, 68 PJ5, 69 PJ6, 70 PG2, 71 PA7, 72 PA6, 73 PA5, 74 PA4, 75 PA3, 76 PA2, 77 PA1, 78 PA0, 79 PJ7, 80 VCC, 81 GND, 82 PK7, 83 PK6, 84 PK5, 85 PK4, 86 PK3, 87 PK2, 88 PK1, 89 PK0, 90 PF7, 91 PF6, 92 PF5, 93 PF4, 94 PF3, 95 PF2, 96 PF1, 97 PF0, 98 AREF, 99 GND, 100 AVCC
CBGA100: A1 GND, A2 AREF, A3 PF0, A4 PF5, A5 PE3, A6 PK0, A7 PK3, A8 PK6, A9 GND, A10 VCC, B1 AVCC, B2 PG5, B3 PF1, B4 PF3, B5 PF6, B6 PK1, B7 PK4, B8 PK7, B9 PA0, B10 PA2, C1 PE2, C2 PE0, C3 PE1, C4 PF4, C5 PF7, C6 PK2, C7 PK5, C8 PJ7, C9 PA1, C10 PA3, D1 PE3, D2 PE4, D3 PE5, D4 PE6, D5 PH2, D6 PA4, D7 PA5, D8 PA6, D9 PA7, D10 PG2, E1 PE7, E2 PH0, E3 PH1, E4 PH3, E5 PH5, E6 PJ6, E7 PJ5, E8 PJ4, E9 PJ3, E10 PJ2, F1 VCC, F2 PH4, F3 PH6, F4 PB0, 5F PL4, F6 PD1, F7 PJ1, F8 PJ0, F9 PC7, F10 GND, G1 GND, G2 PB1, G3 PB2, G4 PB5, G5 PL2, G6 PD0, G7 PD5, G8 PC5, G9 PC6, G10 VCC, H1 PB3, H2 PB4, H3 RESET, H4 PL1, H5 PL3, H6 PL7, H7 PD4, H8 PC4, H9 PC3, H0 PC2, I1 PH7, I2 PG3, I3 PB6, I4 PL0, I5 XTAL2, I6 PL6, I7 PD3, I8 PC1, I9 PC0, I0 PG1, J1 PB7, J2 PG4, J3 VCC, J4 GND, J5 XTAL1, J6 PL5, J7 PD2, J8 PD6, J9 PD7, J10 PG0
