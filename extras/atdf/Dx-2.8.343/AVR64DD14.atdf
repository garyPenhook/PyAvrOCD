# AVR64DD14 device description
Architecture: AVR8X; Family: AVR
Programming and debug interfaces: UPDI
Registers are 8-bit, read-write, reset 0x0 unless marked. A register's access mark holds for its fields unless they carry their own. Offsets are from the block's base; lines under a group give offsets from that group; [hi:lo] are bit positions; {n}, {i} and the like mark numbered series; 'fields as' and 'values as' point back to an identical list; <NAME> marks a mode.

## Ordering variants
AVR64DD14-SOIC: DIP14, pinout DIP14MVIO, up to 32 MHz, -40 to 125 C, 1.8 to 5.5 V

## Memory
data space: start 0x0000 size 0x10000, little endian
  0x00 IO size 0x103F io, rw
  0x1040 LOCKBITS size 0x04 lockbits, rw, page 0x1
  0x1050 FUSES size 0x10 fuses, rw, page 0x1
  0x1080 USER_SIGNATURES size 0x20 user_signatures, rw, page 0x20
  0x1100 SIGNATURES size 0x03 signatures, ro, page 0x80
  0x1103 PROD_SIGNATURES size 0x7D signatures, ro, page 0x80
  0x1400 EEPROM size 0x100 eeprom, rw, page 0x1
  0x6000 INTERNAL_SRAM size 0x2000 ram, rw
  0x8000 MAPPED_PROGMEM size 0x8000 other, rw, page 0x200
prog space: start 0x0000 size 0x10000, little endian
  0x00 PROGMEM size 0x10000 flash, rw, executable, page 0x200

## Peripheral instances (address, pins/pin function, parameters)
AC0 at 0x0680 (AC)
  pins: AINN PD7/AINN2 or PC2/AINN3; AINP PD6/AINP3 or PC3/AINP4
  pin routing set by: AC0.MUXCTRL.MUXNEG, AC0.MUXCTRL.MUXPOS
ADC0 at 0x0600 (ADC)
  pins: AINN PD4/AIN4 or PD5/AIN5 or PD6/AIN6 or PD7/AIN7 or PC1/AIN29 or PC2/AIN30 or PC3/AIN31; AINP PD4/AIN4 or PD5/AIN5 or PD6/AIN6 or PC1/AIN29 or PC2/AIN30 or PC3/AIN31
  pin routing set by: ADC0.MUXNEG.MUXNEG, ADC0.MUXPOS.MUXPOS
BOD at 0x00A0
CCL at 0x01C0
  pins: LUT0_IN0 PA0/IN0; LUT0_IN1 PA1/IN1; LUT1_IN1 PC1/IN1; LUT1_IN2 PC2/IN2; LUT1_OUT PC3; LUT2_OUT PD6/ALT1
  pin routing set by: CCL.LUT0CTRLB.INSEL0, CCL.LUT0CTRLB.INSEL1, CCL.LUT1CTRLB.INSEL1, CCL.LUT1CTRLC.INSEL2, PORTMUX.CCLROUTEA.LUT1, PORTMUX.CCLROUTEA.LUT2
CLKCTRL at 0x0060
  pins: EXTCLK PA0; XTAL32K1 PA0; XTAL32K2 PA1; XTALHF1 PA0; XTALHF2 PA1
CPU at 0x0030
  parameters: CORE_VERSION=V4S
CPUINT at 0x0110
CRCSCAN at 0x0120
DAC0 at 0x06A0 (DAC)
  pins: OUT PD6
EVSYS at 0x0200
  pins: EVOUTC PC2; EVOUTD PD7/ALT1; EVOUTF PF7
  pin routing set by: PORTMUX.EVSYSROUTEA.EVOUTC, PORTMUX.EVSYSROUTEA.EVOUTD, PORTMUX.EVSYSROUTEA.EVOUTF
FUSE at 0x1050
GPR at 0x001C
LOCK at 0x1040
MVIO at 0x00C0
NVMCTRL at 0x1000
PORTA at 0x0400 (PORT)
  pins: PIN0 PA0; PIN1 PA1
PORTC at 0x0440 (PORT)
  pins: PIN1 PC1; PIN2 PC2; PIN3 PC3
PORTD at 0x0460 (PORT)
  pins: PIN4 PD4; PIN5 PD5; PIN6 PD6; PIN7 PD7
PORTF at 0x04A0 (PORT)
  pins: PIN6 PF6; PIN7 PF7
PORTMUX at 0x05E0
RSTCTRL at 0x0040
  pins: RESET PF6
RTC at 0x0140
SIGROW at 0x1100
SLPCTRL at 0x0050
SPI0 at 0x0940 (SPI)
  pins: MISO PA1/ALT3 or PD5/ALT4 or PC1/ALT5 or PC2/ALT6; MOSI PA0/ALT3 or PD4/ALT4 or PC1/ALT6; SS PC1/ALT3 or PD7/ALT4 or PC3/ALT5 or PF7/ALT6; SCK PD6/ALT4 or PC2/ALT5 or PC3/ALT6
  pin routing set by: PORTMUX.SPIROUTEA.SPI0
SYSCFG at 0x0F00
TCA0 at 0x0A00 (TCA)
  pins: WO0 PA0/PORTA; WO1 PA1/PORTA or PC1/PORTC; WO2 PC2/PORTC; WO3 PC3/PORTC; WO4 PD4/PORTD; WO5 PD5/PORTD
  pin routing set by: PORTMUX.TCAROUTEA.TCA0
TCB0 at 0x0B00 (TCB)
TCB1 at 0x0B10 (TCB)
TCD0 at 0x0B80 (TCD)
  pins: WOC2 PD4/ALT4; WOD3 PD5/ALT4
  pin routing set by: PORTMUX.TCDROUTEA.TCD0
TWI0 at 0x0900 (TWI)
  pins: SCL PC3/ALT2 or PA1/ALT3; SDA PC2/ALT2 or PA0/ALT3; SCL_DUAL PC3/ALT3 or PC3; SDA_DUAL PC2/ALT3 or PC2
  pin routing set by: PORTMUX.TWIROUTEA.TWI0
USART0 at 0x0800 (USART)
  pins: RXD PD5/ALT3 or PC2/ALT4 or PA1; TXD PD4/ALT3 or PC1/ALT4 or PA0; XCK PD6/ALT3 or PC3/ALT4; XDIR PD7/ALT3
  pin routing set by: PORTMUX.USARTROUTEA.USART0
USART1 at 0x0820 (USART)
  pins: RXD PD7/ALT2 or PC1; TXD PD6/ALT2; XCK PC2; XDIR PC3
  pin routing set by: PORTMUX.USARTROUTEA.USART1
USERROW at 0x1080
VPORTA at 0x0000 (VPORT)
VPORTC at 0x0008 (VPORT)
VPORTD at 0x000C (VPORT)
VPORTF at 0x0014 (VPORT)
VREF at 0x00B0
  pins: VREFA PD7
WDT at 0x0100
ZCD3 at 0x06D8 (ZCD)
  pins: ZCIN PC2
  pin routing set by: PORTMUX.ZCDROUTEA.ZCD3

## Interrupts
1 NMI (CRCSCAN)
2 VLM (BOD)
3 CFD (CLKCTRL)
4 MVIO
5 CNT (RTC)
6 PIT (RTC)
7 CCL
8 PORT (PORTA)
9 LUNF (TCA0)
9 OVF (TCA0)
10 HUNF (TCA0)
11 CMP0 (TCA0)
11 LCMP0 (TCA0)
12 CMP1 (TCA0)
12 LCMP1 (TCA0)
13 CMP2 (TCA0)
13 LCMP2 (TCA0)
14 INT (TCB0)
15 INT (TCB1)
16 OVF (TCD0)
17 TRIG (TCD0)
18 TWIS (TWI0)
19 TWIM (TWI0)
20 INT (SPI0)
21 RXC (USART0)
22 DRE (USART0)
23 TXC (USART0)
24 PORT (PORTD)
25 AC (AC0)
26 RESRDY (ADC0)
27 WCMP (ADC0)
28 ZCD (ZCD3)
29 PORT (PORTC)
31 RXC (USART1)
32 DRE (USART1)
33 TXC (USART1)
34 PORT (PORTF)
35 EE (NVMCTRL)

## Properties
OCD_FEATURES: BREAK_PIN=PF6, BREAK_PIN_ALT=PF2
SIGNATURES: SIGNATURE0=0x1E, SIGNATURE1=0x96, SIGNATURE2=0x1D

## Pinouts (pin number, pad)
DIP14MVIO: 1 AGND, 2 PF6, 3 PF7, 4 PA0, 5 PA1, 6 PC1, 7 PC2, 8 PC3, 9 VDDIO2, 10 PD4, 11 PD5, 12 PD6, 13 PD7, 14 AVDD
