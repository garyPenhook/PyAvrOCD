# AVR32DA48S device description
Architecture: AVR8X; Family: AVR DA
Programming and debug interfaces: UPDI
Registers are 8-bit, read-write, reset 0x0 unless marked. A register's access mark holds for its fields unless they carry their own. Offsets are from the block's base; lines under a group give offsets from that group; [hi:lo] are bit positions; {n}, {i} and the like mark numbered series; 'fields as' and 'values as' point back to an identical list; <NAME> marks a mode.

## Ordering variants
AVR32DA48S-VQFN/TQFP: QFP48, up to 24 MHz, -40 to 125 C, 1.8 to 5.5 V

## Memory
data space: start 0x0000 size 0x10000, little endian
  0x00 IO size 0x103F io, rw
  0x1040 LOCKBITS size 0x04 lockbits, rw, page 0x1
  0x1050 FUSES size 0x10 fuses, rw, page 0x1
  0x1080 USER_SIGNATURES size 0x20 user_signatures, rw, page 0x20
  0x1100 SIGNATURES size 0x03 signatures, ro, page 0x80
  0x1103 PROD_SIGNATURES size 0x7D signatures, ro, page 0x80
  0x1400 EEPROM size 0x200 eeprom, rw, page 0x1
  0x7000 INTERNAL_SRAM size 0x1000 ram, rw
  0x8000 MAPPED_PROGMEM size 0x8000 other, rw, page 0x200
prog space: start 0x0000 size 0x8000, little endian
  0x00 PROGMEM size 0x8000 flash, rw, executable, page 0x200

## Peripheral instances (address, pins/pin function, parameters)
AC0 at 0x0680 (AC)
  pins: AINN PD3/AINN0 or PD0/AINN1 or PD7/AINN2; AINP PD2/AINP0 or PE0/AINP1 or PE2/AINP2 or PD6/AINP3; OUT PC6/ALT1 or PA7
  pin routing set by: AC0.MUXCTRL.MUXNEG, AC0.MUXCTRL.MUXPOS, PORTMUX.ACROUTEA.AC0
AC1 at 0x0688 (AC)
  pins: AINN PD5/AINN0 or PD0/AINN1 or PD7/AINN2; AINP PD2/AINP0 or PD3/AINP1 or PD4/AINP2 or PD6/AINP3; OUT PC6/ALT1 or PA7
  pin routing set by: AC1.MUXCTRL.MUXNEG, AC1.MUXCTRL.MUXPOS, PORTMUX.ACROUTEA.AC1
AC2 at 0x0690 (AC)
  pins: AINN PD7/AINN0 or PD0/AINN1 or PD7/AINN2; AINP PD2/AINP0 or PD4/AINP1 or PE1/AINP2 or PD6/AINP3; OUT PC6/ALT1 or PA7
  pin routing set by: AC2.MUXCTRL.MUXNEG, AC2.MUXCTRL.MUXPOS, PORTMUX.ACROUTEA.AC2
ADC0 at 0x0600 (ADC)
  pins: AINN PD0/AIN0 or PD1/AIN1 or PD2/AIN2 or PD3/AIN3 or PD4/AIN4 or PD5/AIN5 or PD6/AIN6 or PD7/AIN7 or PE0/AIN8 or PE1/AIN9 or PE2/AIN10 or PE3/AIN11; AINP PD0/AIN0 or PD1/AIN1 or PD2/AIN2 or PD3/AIN3 or PD4/AIN4 or PD5/AIN5 or PD6/AIN6 or PD7/AIN7 or PE0/AIN8 or PE1/AIN9 or PE2/AIN10 or PE3/AIN11 or PF0/AIN16 or PF1/AIN17 or PF2/AIN18 or PF3/AIN19 or PF4/AIN20 or PF5/AIN21
  pin routing set by: ADC0.MUXNEG.MUXNEG, ADC0.MUXPOS.MUXPOS
BOD at 0x0080
CCL at 0x01C0
  pins: LUT0_IN0 PA0/IN0; LUT0_IN1 PA1/IN1; LUT0_IN2 PA2/IN2; LUT1_IN0 PC0/IN0; LUT1_IN1 PC1/IN1; LUT1_IN2 PC2/IN2; LUT2_IN0 PD0/IN0; LUT2_IN1 PD1/IN1; LUT2_IN2 PD2/IN2; LUT3_IN0 PF0/IN0; LUT3_IN1 PF1/IN1; LUT3_IN2 PF2/IN2; LUT4_IN0 PB0/IN0; LUT4_IN1 PB1/IN1; LUT4_IN2 PB2/IN2; LUT0_OUT PA6/ALT1 or PA3; LUT1_OUT PC6/ALT1 or PC3; LUT2_OUT PD6/ALT1 or PD3; LUT3_OUT PF3; LUT4_OUT PB3
  pin routing set by: CCL.LUT0CTRLB.INSEL0, CCL.LUT0CTRLB.INSEL1, CCL.LUT0CTRLC.INSEL2, CCL.LUT1CTRLB.INSEL0, CCL.LUT1CTRLB.INSEL1, CCL.LUT1CTRLC.INSEL2, CCL.LUT2CTRLB.INSEL0, CCL.LUT2CTRLB.INSEL1, CCL.LUT2CTRLC.INSEL2, CCL.LUT3CTRLB.INSEL0, CCL.LUT3CTRLB.INSEL1, CCL.LUT3CTRLC.INSEL2, CCL.LUT4CTRLB.INSEL0, CCL.LUT4CTRLB.INSEL1, CCL.LUT4CTRLC.INSEL2, PORTMUX.CCLROUTEA.LUT0, PORTMUX.CCLROUTEA.LUT1, PORTMUX.CCLROUTEA.LUT2, PORTMUX.CCLROUTEA.LUT3, PORTMUX.CCLROUTEA.LUT4
CLKCTRL at 0x0060
  pins: CLKOUT PA7; EXTCLK PA0; XTAL32K1 PF0; XTAL32K2 PF1
CPU at 0x0030
  parameters: CORE_VERSION=V4S
CPUINT at 0x0110
CRCSCAN at 0x0120
DAC0 at 0x06A0 (DAC)
  pins: OUT PD6
EVSYS at 0x0200
  pins: EVOUTA PA7/ALT1 or PA2; EVOUTB PB2; EVOUTC PC7/ALT1 or PC2; EVOUTD PD7/ALT1 or PD2; EVOUTE PE2; EVOUTF PF2
  pin routing set by: PORTMUX.EVSYSROUTEA.EVOUTA, PORTMUX.EVSYSROUTEA.EVOUTB, PORTMUX.EVSYSROUTEA.EVOUTC, PORTMUX.EVSYSROUTEA.EVOUTD, PORTMUX.EVSYSROUTEA.EVOUTE, PORTMUX.EVSYSROUTEA.EVOUTF
FUSE at 0x1050
GPR at 0x001C
LOCK at 0x1040
NVMCTRL at 0x1000
PORTA at 0x0400 (PORT)
  pins: PIN{n} PA{n} (n=0..7)
PORTB at 0x0420 (PORT)
  pins: PIN0 PB0; PIN1 PB1; PIN2 PB2; PIN3 PB3; PIN4 PB4; PIN5 PB5
PORTC at 0x0440 (PORT)
  pins: PIN{n} PC{n} (n=0..7)
PORTD at 0x0460 (PORT)
  pins: PIN{n} PD{n} (n=0..7)
PORTE at 0x0480 (PORT)
  pins: PIN0 PE0; PIN1 PE1; PIN2 PE2; PIN3 PE3
PORTF at 0x04A0 (PORT)
  pins: PIN0 PF0; PIN1 PF1; PIN2 PF2; PIN3 PF3; PIN4 PF4; PIN5 PF5; PIN6 PF6
PORTMUX at 0x05E0
PTC
  pins: XY{n} PA{n} (n=0..7); XY8 PB0; XY9 PB1; XY10 PB2; XY11 PB3; XY12 PB4; XY13 PB5; XY{n} PD{n-16} (n=16..23); XY24 PE0; XY25 PE1; XY26 PE2; XY27 PE3; XY32 PF0; XY33 PF1; XY34 PF2; XY35 PF3; XY36 PF4; XY37 PF5
RSTCTRL at 0x0040
  pins: RESET PF6
RTC at 0x0140
SIGROW at 0x1100
SLPCTRL at 0x0050
SPI0 at 0x0940 (SPI)
  pins: MISO PE1/ALT1 or PA5; MOSI PE0/ALT1 or PA4; SCK PE2/ALT1 or PA6; SS PE3/ALT1 or PA7
  pin routing set by: PORTMUX.SPIROUTEA.SPI0
SPI1 at 0x0960 (SPI)
  pins: MISO PC5/ALT1 or PB5/ALT2 or PC1; MOSI PC4/ALT1 or PB4/ALT2 or PC0; SCK PC6/ALT1 or PC2; SS PC7/ALT1 or PC3
  pin routing set by: PORTMUX.SPIROUTEA.SPI1
SYSCFG at 0x0F00
TCA0 at 0x0A00 (TCA)
  pins: WO0 PA0/PORTA or PB0/PORTB or PC0/PORTC or PD0/PORTD or PE0/PORTE or PF0/PORTF; WO1 PA1/PORTA or PB1/PORTB or PC1/PORTC or PD1/PORTD or PE1/PORTE or PF1/PORTF; WO2 PA2/PORTA or PB2/PORTB or PC2/PORTC or PD2/PORTD or PE2/PORTE or PF2/PORTF; WO3 PA3/PORTA or PB3/PORTB or PC3/PORTC or PD3/PORTD or PE3/PORTE or PF3/PORTF; WO4 PA4/PORTA or PB4/PORTB or PC4/PORTC or PD4/PORTD or PF4/PORTF; WO5 PA5/PORTA or PB5/PORTB or PC5/PORTC or PD5/PORTD or PF5/PORTF
  pin routing set by: PORTMUX.TCAROUTEA.TCA0
TCA1 at 0x0A40 (TCA)
  pins: WO0 PB0/PORTB or PC4/PORTC; WO1 PB1/PORTB or PC5/PORTC; WO2 PB2/PORTB or PC6/PORTC; WO3 PB3/PORTB; WO4 PB4/PORTB; WO5 PB5/PORTB
  pin routing set by: PORTMUX.TCAROUTEA.TCA1
TCB0 at 0x0B00 (TCB)
  pins: WO PF4/ALT1 or PA2
  pin routing set by: PORTMUX.TCBROUTEA.TCB0
TCB1 at 0x0B10 (TCB)
  pins: WO PF5/ALT1 or PA3
  pin routing set by: PORTMUX.TCBROUTEA.TCB1
TCB2 at 0x0B20 (TCB)
  pins: WO PB4/ALT1 or PC0
  pin routing set by: PORTMUX.TCBROUTEA.TCB2
TCB3 at 0x0B30 (TCB)
  pins: WO PC1/ALT1 or PB5
  pin routing set by: PORTMUX.TCBROUTEA.TCB3
TCB4 at 0x0B40 (TCB)
  pins: WO PC6/ALT1
  pin routing set by: PORTMUX.TCBROUTEA.TCB4
TCD0 at 0x0B80 (TCD)
  pins: WOA PB4/ALT1 or PF0/ALT2 or PA4; WOB PB5/ALT1 or PF1/ALT2 or PA5; WOC PF2/ALT2 or PA6; WOD PF3/ALT2 or PA7
  pin routing set by: PORTMUX.TCDROUTEA.TCD0
TWI0 at 0x0900 (TWI)
  pins: SCL PA3/ALT1 or PC3/ALT2 or PA3; SCL_DUAL PC7/ALT1 or PC7/ALT2 or PC3; SDA PA2/ALT1 or PC2/ALT2 or PA2; SDA_DUAL PC6/ALT1 or PC6/ALT2 or PC2
  pin routing set by: PORTMUX.TWIROUTEA.TWI0
TWI1 at 0x0920 (TWI)
  pins: SCL PF3/ALT1 or PB3/ALT2 or PF3; SDA PF2/ALT1 or PB2/ALT2 or PF2; SCL_DUAL PB3; SDA_DUAL PB2
  pin routing set by: PORTMUX.TWIROUTEA.TWI1
USART0 at 0x0800 (USART)
  pins: RXD PA5/ALT1 or PA1; TXD PA4/ALT1 or PA0; XCK PA6/ALT1 or PA2; XDIR PA7/ALT1 or PA3
  pin routing set by: PORTMUX.USARTROUTEA.USART0
USART1 at 0x0820 (USART)
  pins: RXD PC5/ALT1 or PC1; TXD PC4/ALT1 or PC0; XCK PC6/ALT1 or PC2; XDIR PC7/ALT1 or PC3
  pin routing set by: PORTMUX.USARTROUTEA.USART1
USART2 at 0x0840 (USART)
  pins: RXD PF5/ALT1 or PF1; TXD PF4/ALT1 or PF0; XCK PF2; XDIR PF3
  pin routing set by: PORTMUX.USARTROUTEA.USART2
USART3 at 0x0860 (USART)
  pins: RXD PB5/ALT1 or PB1; TXD PB4/ALT1 or PB0; XCK PB2; XDIR PB3
  pin routing set by: PORTMUX.USARTROUTEA.USART3
USART4 at 0x0880 (USART)
  pins: RXD PE1; TXD PE0; XCK PE2; XDIR PE3
  pin routing set by: PORTMUX.USARTROUTEB.USART4
USERROW at 0x1080
VPORTA at 0x0000 (VPORT)
VPORTB at 0x0004 (VPORT)
VPORTC at 0x0008 (VPORT)
VPORTD at 0x000C (VPORT)
VPORTE at 0x0010 (VPORT)
VPORTF at 0x0014 (VPORT)
VREF at 0x00A0
  pins: VREFA PD7
WDT at 0x0100
ZCD0 at 0x06C0 (ZCD)
  pins: ZCIN PD1; OUT PC7/ALT1 or PA7
  pin routing set by: PORTMUX.ZCDROUTEA.ZCD0
ZCD1 at 0x06C8 (ZCD)
  pins: ZCIN PE3; OUT PC7/ALT1 or PA7
  pin routing set by: PORTMUX.ZCDROUTEA.ZCD1

## Interrupts
1 NMI (CRCSCAN)
2 VLM (BOD)
3 CNT (RTC)
4 PIT (RTC)
5 CCL
6 PORT (PORTA)
7 LUNF (TCA0)
7 OVF (TCA0)
8 HUNF (TCA0)
9 CMP0 (TCA0)
9 LCMP0 (TCA0)
10 CMP1 (TCA0)
10 LCMP1 (TCA0)
11 CMP2 (TCA0)
11 LCMP2 (TCA0)
12 INT (TCB0)
13 INT (TCB1)
14 OVF (TCD0)
15 TRIG (TCD0)
16 TWIS (TWI0)
17 TWIM (TWI0)
18 INT (SPI0)
19 RXC (USART0)
20 DRE (USART0)
21 TXC (USART0)
22 PORT (PORTD)
23 AC (AC0)
24 RESRDY (ADC0)
25 WCMP (ADC0)
26 ZCD (ZCD0)
27 PTC
28 AC (AC1)
29 PORT (PORTC)
30 INT (TCB2)
31 RXC (USART1)
32 DRE (USART1)
33 TXC (USART1)
34 PORT (PORTF)
35 EE (NVMCTRL)
36 INT (SPI1)
37 RXC (USART2)
38 DRE (USART2)
39 TXC (USART2)
40 AC (AC2)
41 INT (TCB3)
42 TWIS (TWI1)
43 TWIM (TWI1)
44 PORT (PORTB)
45 PORT (PORTE)
46 LUNF (TCA1)
46 OVF (TCA1)
47 HUNF (TCA1)
48 CMP0 (TCA1)
48 LCMP0 (TCA1)
49 CMP1 (TCA1)
49 LCMP1 (TCA1)
50 CMP2 (TCA1)
50 LCMP2 (TCA1)
51 ZCD (ZCD1)
52 RXC (USART3)
53 DRE (USART3)
54 TXC (USART3)
55 RXC (USART4)
56 DRE (USART4)
57 TXC (USART4)
60 INT (TCB4)

## Properties
OCD_FEATURES: BREAK_PIN=PF6, BREAK_PIN_ALT=PF2
SIGNATURES: SIGNATURE0=0x1E, SIGNATURE1=0x95, SIGNATURE2=0x70

## Pinouts (pin number, pad)
QFP48: 1 PA5, 2 PA6, 3 PA7, 4 PB0, 5 PB1, 6 PB2, 7 PB3, 8 PB4, 9 PB5, 10 PC0, 11 PC1, 12 PC2, 13 PC3, 14 VDD0, 15 GND0, 16 PC4, 17 PC5, 18 PC6, 19 PC7, 20 PD0, 21 PD1, 22 PD2, 23 PD3, 24 PD4, 25 PD5, 26 PD6, 27 PD7, 28 AVDD, 29 AGND, 30 PE0, 31 PE1, 32 PE2, 33 PE3, 34 PF0, 35 PF1, 36 PF2, 37 PF3, 38 PF4, 39 PF5, 40 PF6, 41 UPDI, 42 VDD1, 43 GND1, 44 PA0, 45 PA1, 46 PA2, 47 PA3, 48 PA4
