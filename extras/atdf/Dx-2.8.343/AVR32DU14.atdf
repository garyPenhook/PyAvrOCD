# AVR32DU14 device description
Architecture: AVR8X; Family: AVR
Programming and debug interfaces: UPDI
Registers are 8-bit, read-write, reset 0x0 unless marked. A register's access mark holds for its fields unless they carry their own. Offsets are from the block's base; lines under a group give offsets from that group; [hi:lo] are bit positions; {n}, {i} and the like mark numbered series; 'fields as' and 'values as' point back to an identical list; <NAME> marks a mode.

## Ordering variants
AVR32DU14-SOIC: DIP14, pinout DIP14USB, up to 32 MHz, -40 to 85 C, 1.8 to 5.5 V

## Memory
data space: start 0x0000 size 0x10000, little endian
  0x00 IO size 0x103F io, rw
  0x1040 LOCKBITS size 0x04 lockbits, rw, page 0x1
  0x1050 FUSES size 0x10 fuses, rw, page 0x1
  0x1080 SIGNATURES size 0x03 signatures, ro, page 0x80
  0x1083 PROD_SIGNATURES size 0x7D signatures, ro, page 0x80
  0x1100 BOOTROW size 0x100 user_signatures, rw, page 0x100
  0x1200 USER_SIGNATURES size 0x200 user_signatures, rw, page 0x200
  0x1400 EEPROM size 0x100 eeprom, rw, page 0x1
  0x7000 INTERNAL_SRAM size 0x1000 ram, rw
  0x8000 MAPPED_PROGMEM size 0x8000 other, rw, page 0x200
prog space: start 0x0000 size 0x8000, little endian
  0x00 PROGMEM size 0x8000 flash, rw, executable, page 0x200

## Peripheral instances (address, pins/pin function, parameters)
AC0 at 0x0680 (AC)
  pins: AINN PD7/AINN2; AINP PD6/AINP3 or PC3/AINP4
  pin routing set by: AC0.MUXCTRL.MUXNEG, AC0.MUXCTRL.MUXPOS
ADC0 at 0x0600 (ADC)
  pins: AIN PD4/AIN4 or PD5/AIN5 or PD6/AIN6 or PD7/AIN7 or PC3/AIN31
  pin routing set by: ADC0.MUXPOS.MUXPOS
BOD at 0x00A0
BOOTROW at 0x1100
CCL at 0x01C0
  pins: LUT0_IN0 PA0/IN0; LUT0_IN1 PA1/IN1; LUT1_OUT PC3; LUT2_OUT PD6/ALT1
  pin routing set by: CCL.LUT0CTRLB.INSEL0, CCL.LUT0CTRLB.INSEL1, PORTMUX.CCLROUTEA.LUT1, PORTMUX.CCLROUTEA.LUT2
CLKCTRL at 0x0060
  pins: EXTCLK PA0; XTAL32K1 PA0; XTAL32K2 PA1; XTALHF1 PA0; XTALHF2 PA1
CPU at 0x0030
  parameters: CORE_VERSION=V4S
CPUINT at 0x0110
CRCSCAN at 0x0120
EVSYS at 0x0200
  pins: EVOUTD PD7/ALT1; EVOUTF PF7/ALT1
  pin routing set by: PORTMUX.EVSYSROUTEA.EVOUTD, PORTMUX.EVSYSROUTEA.EVOUTF
FUSE at 0x1050
GPR at 0x001C
LOCK at 0x1040
NVMCTRL at 0x1000
PORTA at 0x0400 (PORT)
  pins: PIN0 PA0; PIN1 PA1
PORTC at 0x0440 (PORT)
  pins: PIN3 PC3
PORTD at 0x0460 (PORT)
  pins: PIN4 PD4; PIN5 PD5; PIN6 PD6; PIN7 PD7
PORTF at 0x04A0 (PORT)
  pins: PIN6 PF6; PIN7 PF7
PORTMUX at 0x05E0
RSTCTRL at 0x0040
  pins: RESET PF6
RTC at 0x0140
SIGROW at 0x1080
SLPCTRL at 0x0050
SPI0 at 0x0940 (SPI)
  pins: MISO PD5/ALT4; MOSI PD4/ALT4; SCK PD6/ALT4; SS PD7/ALT4
  pin routing set by: PORTMUX.SPIROUTEA.SPI0
SYSCFG at 0x0F00
TCA0 at 0x0A00 (TCA)
  pins: WO0 PA0/PORTA; WO1 PA1/PORTA; WO3 PC3/PORTC; WO4 PD4/PORTD; WO5 PD5/PORTD
  pin routing set by: PORTMUX.TCAROUTEA.TCA0
TCB0 at 0x0B00 (TCB)
TCB1 at 0x0B10 (TCB)
TWI0 at 0x0900 (TWI)
  pins: SCL PA1/ALT3; SDA PA0/ALT3
  pin routing set by: PORTMUX.TWIROUTEA.TWI0
USART0 at 0x0800 (USART)
  pins: RXD PD5/ALT3 or PA1; TXD PD4/ALT3 or PA0; XCK PD6/ALT3; XDIR PD7/ALT3
  pin routing set by: PORTMUX.USARTROUTEA.USART0
USART1 at 0x0820 (USART)
  pins: RXD PD7/ALT2; TXD PD6/ALT2
  pin routing set by: PORTMUX.USARTROUTEA.USART1
USB0 at 0xC00 (USB)
  pins: DM DM; DP DP
  parameters: USB_MAX_ENDPOINTS=16
USERROW at 0x1200
VPORTA at 0x0000 (VPORT)
VPORTC at 0x0008 (VPORT)
VPORTD at 0x000C (VPORT)
VPORTF at 0x0014 (VPORT)
VREF at 0x00B0
  pins: VREFA PD7
WDT at 0x0100

## Interrupts
1 NMI (CRCSCAN)
2 VLM (BOD)
3 CFD (CLKCTRL)
4 CNT (RTC)
5 PIT (RTC)
6 CCL
7 BUSEVENT (USB0)
8 TRNCOMPL (USB0)
9 PORT (PORTA)
10 LUNF (TCA0)
10 OVF (TCA0)
11 HUNF (TCA0)
12 CMP0 (TCA0)
12 LCMP0 (TCA0)
13 CMP1 (TCA0)
13 LCMP1 (TCA0)
14 CMP2 (TCA0)
14 LCMP2 (TCA0)
15 INT (TCB0)
16 TWIS (TWI0)
17 TWIM (TWI0)
18 INT (SPI0)
19 RXC (USART0)
20 DRE (USART0)
21 TXC (USART0)
22 PORT (PORTD)
23 PORT (PORTC)
24 PORT (PORTF)
25 NVMREADY (NVMCTRL)
26 RXC (USART1)
27 DRE (USART1)
28 TXC (USART1)
29 INT (TCB1)
30 AC (AC0)
31 ERROR (ADC0)
32 RESRDY (ADC0)
33 SAMPRDY (ADC0)

## Properties
OCD_FEATURES: BREAK_PIN=PF6, BREAK_PIN_ALT=PF2
SIGNATURES: SIGNATURE0=0x1E, SIGNATURE1=0x95, SIGNATURE2=0x4F

## Pinouts (pin number, pad)
DIP14USB: 1 GND0, 2 PF6, 3 PF7, 4 PA0, 5 PA1, 6 VUSB, 7 DM, 8 DP, 9 PC3, 10 PD4, 11 PD5, 12 PD6, 13 PD7, 14 VDD0
