# AVR32SD20 device description
Architecture: AVR8X; Family: AVR
Programming and debug interfaces: UPDI
Registers are 8-bit, read-write, reset 0x0 unless marked. A register's access mark holds for its fields unless they carry their own. Offsets are from the block's base; lines under a group give offsets from that group; [hi:lo] are bit positions; {n}, {i} and the like mark numbered series; 'fields as' and 'values as' point back to an identical list; <NAME> marks a mode.

## Ordering variants
AVR32SD20-SSOP: DIP20, pinout DIP20MVIO, up to 20 MHz, -40 to 125 C, 1.8 to 5.5 V

## Memory
data space: start 0x0000 size 0x08000, little endian
  0x00 IO size 0x103F io, rw
  0x1040 LOCKBITS size 0x04 lockbits, rw, page 0x1
  0x1050 FUSES size 0x10 fuses, rw, page 0x1
  0x1080 SIGNATURES size 0x03 signatures, ro, page 0x80
  0x1083 PROD_SIGNATURES size 0x7D signatures, ro, page 0x80
  0x1100 BOOTROW size 0x100 user_signatures, rw, page 0x40
  0x1200 USER_SIGNATURES size 0x200 user_signatures, rw, page 0x200
  0x1400 EEPROM size 0x100 eeprom, rw, page 0x1
  0x7000 INTERNAL_SRAM size 0x1000 ram, rw
  0x8000 MAPPED_PROGMEM size 0x8000 other, rw, page 0x200
prog space: start 0x0000 size 0x08000, little endian
  0x00 PROGMEM size 0x8000 flash, rw, executable, page 0x200

## Peripheral instances (address, pins/pin function, parameters)
AC0 at 0x0680 (AC)
  pins: AINN PD7/AINN2 or PC2/AINN3; AINP PD6/AINP3 or PC3/AINP4; OUT PA7
  pin routing set by: AC0.MUXCTRL.MUXNEG, AC0.MUXCTRL.MUXPOS, PORTMUX.ACROUTEA.AC0
AC1 at 0x0688 (AC)
  pins: AINN PD5/AINN0 or PD7/AINN2 or PC2/AINN3; AINP PD4/AINP2 or PD6/AINP3 or PC3/AINP4; OUT PA7
  pin routing set by: AC1.MUXCTRL.MUXNEG, AC1.MUXCTRL.MUXPOS, PORTMUX.ACROUTEA.AC1
AC2 at 0x0690 (AC)
  pins: AINN PD7/AINN0 or PD7/AINN2; AINP PD4/AINP1 or PD6/AINP3; OUT PA7
  pin routing set by: AC2.MUXCTRL.MUXNEG, AC2.MUXCTRL.MUXPOS, PORTMUX.ACROUTEA.AC2
ADC0 at 0x0600 (ADC)
  pins: AIN PD4/AIN4 or PD5/AIN5 or PD6/AIN6 or PD7/AIN7 or PA2/AIN22 or PA3/AIN23 or PA4/AIN24 or PA5/AIN25 or PA6/AIN26 or PA7/AIN27 or PC1/AIN29 or PC2/AIN30 or PC3/AIN31
  pin routing set by: ADC0.MUXPOS.MUXPOS
ADC1 at 0x0640 (ADC)
  pins: AIN PD4/AIN4 or PD5/AIN5 or PD6/AIN6 or PD7/AIN7 or PA4/AIN24 or PA5/AIN25 or PA6/AIN26 or PA7/AIN27
  pin routing set by: ADC1.MUXPOS.MUXPOS
BOD at 0x0060
BOOTROW at 0x1100
CCL at 0x01C0
  pins: LUT0_IN0 PA0/IN0; LUT0_IN1 PA1/IN1; LUT0_IN2 PA2/IN2; LUT1_IN1 PC1/IN1; LUT1_IN2 PC2/IN2; LUT0_OUT PA6/ALT1 or PA3; LUT1_OUT PC3; LUT2_OUT PD6/ALT1
  pin routing set by: CCL.LUT0CTRLB.INSEL0, CCL.LUT0CTRLB.INSEL1, CCL.LUT0CTRLC.INSEL2, CCL.LUT1CTRLB.INSEL1, CCL.LUT1CTRLC.INSEL2, PORTMUX.CCLROUTEA.LUT0, PORTMUX.CCLROUTEA.LUT1, PORTMUX.CCLROUTEA.LUT2
CLKCTRL at 0x0080
  pins: CLKOUT PA7; EXTCLK PA0; XTAL32K1 PA0; XTAL32K2 PA1; XTALHF1 PA0; XTALHF2 PA1
CPU at 0x0030
  parameters: CORE_VERSION=V4S
CPUINT at 0x0120
CRCSCAN at 0x0130
DAC0 at 0x06A0 (DAC)
  pins: OUT PD6
ERRCTRL at 0x0E40
  pins: HEARTBEAT PA4/ALT1 or PA6/ALT2 or PA7/ALT3 or PD4/ALT4 or PA2
  pin routing set by: PORTMUX.HEARTROUTEA.HEART
EVSYS at 0x0200
  pins: EVOUTA PA7/ALT1 or PA2; EVOUTC PC2; EVOUTD PD7/ALT1
  pin routing set by: PORTMUX.EVSYSROUTEA.EVOUTA, PORTMUX.EVSYSROUTEA.EVOUTC, PORTMUX.EVSYSROUTEA.EVOUTD
FUSE at 0x1050
GPR at 0x001C
LOCK at 0x1040
MVIO at 0x0100
NVMCTRL at 0x1000
PORTA at 0x0400 (PORT)
  pins: PIN{n} PA{n} (n=0..7)
PORTC at 0x0440 (PORT)
  pins: PIN1 PC1; PIN2 PC2; PIN3 PC3
PORTD at 0x0460 (PORT)
  pins: PIN4 PD4; PIN5 PD5; PIN6 PD6; PIN7 PD7
PORTF at 0x04A0 (PORT)
  pins: PIN6 PF6; PIN7 PF7
PORTMUX at 0x05E0
RAMCTRL at 0x0E30
RSTCTRL at 0x0040
  pins: RESET PF6
RTC at 0x0140
SIGROW at 0x1080
SLPCTRL at 0x0050
SPI0 at 0x0940 (SPI)
  pins: MISO PA1/ALT3 or PD5/ALT4 or PC1/ALT5 or PC2/ALT6 or PA5; MOSI PA0/ALT3 or PD4/ALT4 or PC1/ALT6 or PA4; SS PC1/ALT3 or PD7/ALT4 or PC3/ALT5 or PA7; SCK PD6/ALT4 or PC2/ALT5 or PC3/ALT6 or PA6
  pin routing set by: PORTMUX.SPIROUTEA.SPI0
SPI1 at 0x0960 (SPI)
  pins: MISO PC1; SCK PC2; SS PC3
  pin routing set by: PORTMUX.SPIROUTEA.SPI1
SWDT at 0x0E20
SYSCFG at 0x0F00
TCA0 at 0x0A00 (TCA)
  pins: WO1 PC1/ALT2 or PA1; WO2 PC2/ALT2 or PA2; WO3 PC3/ALT2 or PA3; WO4 PD4/ALT3 or PA4; WO5 PD5/ALT3 or PA5; WO0 PA0
  pin routing set by: PORTMUX.TCAROUTEA.TCA0
TCB0 at 0x0B00 (TCB)
  pins: WO PA2
  pin routing set by: PORTMUX.TCBROUTEA.TCB0
TCB1 at 0x0B10 (TCB)
  pins: WO PA3
  pin routing set by: PORTMUX.TCBROUTEA.TCB1
TCB2 at 0x0B20 (TCB)
TCB3 at 0x0B30 (TCB)
  pins: WO PC1/ALT1
  pin routing set by: PORTMUX.TCBROUTEA.TCB3
TCD0 at 0x0B80 (TCD)
  pins: WOA PA4/ALT4 or PA4; WOB PA5/ALT4 or PA5; WOC PD4/ALT4 or PA6; WOD PD5/ALT4 or PA7
  pin routing set by: PORTMUX.TCDROUTEA.TCD0
TWI0 at 0x0900 (TWI)
  pins: SCL PA3/ALT1 or PC3/ALT2 or PA1/ALT3 or PA3; SDA PA2/ALT1 or PC2/ALT2 or PA0/ALT3 or PA2; SCL_DUAL PC3/ALT3 or PC3; SDA_DUAL PC2/ALT3 or PC2
  pin routing set by: PORTMUX.TWIROUTEA.TWI0
USART0 at 0x0800 (USART)
  pins: RXD PA5/ALT1 or PA3/ALT2 or PD5/ALT3 or PC2/ALT4 or PA1; TXD PA4/ALT1 or PA2/ALT2 or PD4/ALT3 or PC1/ALT4 or PA0; XCK PA6/ALT1 or PD6/ALT3 or PC3/ALT4 or PA2; XDIR PA7/ALT1 or PD7/ALT3 or PA3
  pin routing set by: PORTMUX.USARTROUTEA.USART0
USART1 at 0x0820 (USART)
  pins: RXD PD7/ALT2 or PC1; TXD PD6/ALT2; XCK PC2; XDIR PC3
  pin routing set by: PORTMUX.USARTROUTEA.USART1
USERROW at 0x1200
VPORTA at 0x0000 (VPORT)
VPORTC at 0x0008 (VPORT)
VPORTD at 0x000C (VPORT)
VPORTF at 0x0014 (VPORT)
VREF at 0x0070
WDT at 0x0110
ZCD3 at 0x06D8 (ZCD)
  pins: ZCIN PC2; OUT PA7
  pin routing set by: PORTMUX.ZCDROUTEA.ZCD3

## Interrupts
1 NMI (CPU CRCSCAN ERRCTRL)
2 VLM (BOD)
3 INT (ERRCTRL)
4 INT (CLKCTRL)
5 INT (SLPCTRL)
6 INT (SWDT)
7 ERROR (NVMCTRL)
8 INT (RAMCTRL)
9 INT (CRCSCAN)
10 MVIO
11 CNT (RTC)
12 PIT (RTC)
13 CCL
14 PORT (PORTA)
15 OVF (TCA0)
16 HUNF (TCA0)
17 CMP0 (TCA0)
18 CMP1 (TCA0)
19 CMP2 (TCA0)
20 INT (TCB0)
21 INT (TCB1)
22 OVF (TCD0)
23 TRIG (TCD0)
24 TWIS (TWI0)
25 TWIM (TWI0)
26 INT (SPI0)
27 INT (SPI1)
28 RXC (USART0)
29 DRE (USART0)
30 TXC (USART0)
31 PORT (PORTD)
32 AC (AC0)
33 AC (AC1)
34 AC (AC2)
35 ERROR (ADC0)
36 RESRDY (ADC0)
37 SAMPRDY (ADC0)
38 ERROR (ADC1)
39 RESRDY (ADC1)
40 SAMPRDY (ADC1)
41 ZCD (ZCD3)
42 PORT (PORTC)
43 RXC (USART1)
44 DRE (USART1)
45 TXC (USART1)
46 PORT (PORTF)
47 READY (NVMCTRL)
48 INT (TCB2)
49 INT (TCB3)

## Properties
OCD_FEATURES: BREAK_PIN=PA6, BREAK_PIN_ALT=PF2
SIGNATURES: SIGNATURE0=0x1E, SIGNATURE1=0x95, SIGNATURE2=0x54

## Pinouts (pin number, pad)
DIP20MVIO: 1 GND, 2 PF6, 3 PF7, 4 PA0, 5 PA1, 6 PA2, 7 PA3, 8 PA4, 9 PA5, 10 PA6, 11 PA7, 12 PC1, 13 PC2, 14 PC3, 15 VDDIO2, 16 PD4, 17 PD5, 18 PD6, 19 PD7, 20 VDD
