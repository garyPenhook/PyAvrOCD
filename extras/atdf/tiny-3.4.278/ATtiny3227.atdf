# ATtiny3227 device description
Architecture: AVR8X; Family: tinyAVR 2
Programming and debug interfaces: UPDI
Registers are 8-bit, read-write, reset 0x0 unless marked. A register's access mark holds for its fields unless they carry their own. Offsets are from the block's base; lines under a group give offsets from that group; [hi:lo] are bit positions; {n}, {i} and the like mark numbered series; 'fields as' and 'values as' point back to an identical list; <NAME> marks a mode.

## Ordering variants
ATtiny3227-VQFN: QFP24, up to 20 MHz, -40 to 125 C, 1.8 to 5.5 V

## Memory
data space: start 0x0000 size 0x10000, little endian
  0x00 IO size 0x1100 io, rw
  0x1100 SIGNATURES size 0x03 signatures, ro, page 0x80
  0x1103 PROD_SIGNATURES size 0x3D signatures, ro, page 0x80
  0x1280 FUSES size 0x0A fuses, rw, page 0x20
  0x128A LOCKBITS size 0x01 lockbits, rw, page 0x20
  0x1300 USER_SIGNATURES size 0x20 user_signatures, rw, page 0x20
  0x1400 EEPROM size 0x100 eeprom, rw, page 0x40
  0x3400 INTERNAL_SRAM size 0xC00 ram, rw
  0x8000 MAPPED_PROGMEM size 0x8000 other, rw, page 0x80
prog space: start 0x0000 size 0x8000, little endian
  0x00 PROGMEM size 0x8000 flash, rw, executable, page 0x80

## Peripheral instances (address, pins/pin function, parameters)
AC0 at 0x0680 (AC)
  pins: N0 PA6; N1 PB4; N2 PB0; OUT0 PA5; P0 PA7; P1 PB5; P2 PB1; P3 PB6
ADC0 at 0x0600 (ADC)
  pins: AIN1 PA1/AIN0; AIN2 PA2/AIN0; AIN3 PA3/AIN0; AIN4 PA4/AIN0; AIN5 PA5/AIN0; AIN6 PA6/AIN0; AIN7 PA7/AIN0; AIN8 PB5/AIN0; AIN9 PB4/AIN0; AIN10 PB1/AIN0; AIN11 PB0/AIN0; AIN12 PC0/AIN0; AIN13 PC1/AIN0; AIN14 PC2/AIN0; AIN15 PC3/AIN0
BOD at 0x0080
CCL at 0x01C0
  pins: LUT0_IN0 PA0/CCL_IN; LUT0_IN1 PA1/CCL_IN; LUT0_IN2 PA2/CCL_IN; LUT1_IN0 PC3/CCL_IN; LUT1_IN1 PC4/CCL_IN; LUT1_IN2 PC5/CCL_IN; LUT2_IN0 PB0/CCL_IN; LUT2_IN1 PB1/CCL_IN; LUT2_IN2 PB2/CCL_IN; LUT3_IN0 PC0/CCL_IN; LUT3_IN1 PC1/CCL_IN; LUT3_IN2 PC2/CCL_IN; LUT0_OUT PA4 or PB4/CCL_ALT; LUT1_OUT PA7 or PC1/CCL_ALT; LUT2_OUT PB3 or PB6/CCL_ALT; LUT3_OUT PC4 or PA5/CCL_ALT
  pin routing set by: PORTMUX.CCLROUTEA.LUT0, PORTMUX.CCLROUTEA.LUT1, PORTMUX.CCLROUTEA.LUT2, PORTMUX.CCLROUTEA.LUT3
CLKCTRL at 0x0060
  pins: CLKI PA3; CLKO PB5; TOSC1 PB3; TOSC2 PB2
CPU at 0x0030
  pins: BREAK PA1/OTHER; BREAK_ALT PC4/OTHER
  parameters: CORE_VERSION=V4
CPUINT at 0x0110
CRCSCAN at 0x0120
EVSYS at 0x0180
  pins: EVOUT0 PA2 or PA7/EVSYS_ALT; EVOUT1 PB2 or PB7/EVSYS_ALT; EVOUT2 PC2
  pin routing set by: PORTMUX.EVSYSROUTEA.EVOUTA, PORTMUX.EVSYSROUTEA.EVOUTB, PORTMUX.EVSYSROUTEA.EVOUTC
FUSE at 0x1280
GPIO at 0x001C
LOCKBIT at 0x128A
NVMCTRL at 0x1000
PORTA at 0x0400 (PORT)
  pins: PIN{n} PA{n}/IOPORT (n=0..7)
PORTB at 0x0420 (PORT)
  pins: PIN{n} PB{n}/IOPORT (n=0..7)
PORTC at 0x0440 (PORT)
  pins: PIN0 PC0/IOPORT; PIN1 PC1/IOPORT; PIN2 PC2/IOPORT; PIN3 PC3/IOPORT; PIN4 PC4/IOPORT; PIN5 PC5/IOPORT
PORTMUX at 0x05E0
RSTCTRL at 0x0040
  pins: RESET PA0/OTHER; RESET_ALT PB4/OTHER
RTC at 0x0140
SIGROW at 0x1100
SLPCTRL at 0x0050
SPI0 at 0x08C0 (SPI)
  pins: MISO PA2 or PC1/SPI_ALT; MOSI PA1 or PC2/SPI_ALT; SCK PA3 or PC0/SPI_ALT; SS PA4 or PC3/SPI_ALT
  pin routing set by: PORTMUX.SPIROUTEA.SPI0
SYSCFG at 0x0F00
  pins: UPDI PA0/PDI
TCA0 at 0x0A00 (TCA)
  pins: WO0 PB0 or PB3/TCA_ALT; WO1 PB1 or PB4/TCA_ALT; WO2 PB2 or PB5/TCA_ALT; WO3 PA3 or PC3/TCA_ALT; WO4 PA4 or PC4/TCA_ALT; WO5 PA5 or PC5/TCA_ALT
  pin routing set by: PORTMUX.TCAROUTEA.TCA0
TCB0 at 0x0A80 (TCB)
  pins: WO PA5 or PC0/TCB0_ALT
  pin routing set by: PORTMUX.TCBROUTEA.TCB0
TCB1 at 0x0A90 (TCB)
  pins: WO PA3 or PC4/TCB1_ALT
  pin routing set by: PORTMUX.TCBROUTEA.TCB1
TWI0 at 0x08A0 (TWI)
  pins: SCL PB0/I2C; SDA PB1/I2C
USART0 at 0x0800 (USART)
  pins: RXD PB3 or PA2/USART0_ALT; TXD PB2 or PA1/USART0_ALT; XCK PB1 or PA3/USART0_ALT; XDIR PB0 or PA4/USART0_ALT
  pin routing set by: PORTMUX.USARTROUTEA.USART0
USART1 at 0x0820 (USART)
  pins: RXD PA2 or PC1/USART1_ALT; TXD PA1 or PC2/USART1_ALT; XCK PA3 or PC0/USART1_ALT; XDIR PA4 or PC3/USART1_ALT
  pin routing set by: PORTMUX.USARTROUTEA.USART1
USERROW at 0x1300
VPORTA at 0x0000 (VPORT)
VPORTB at 0x0004 (VPORT)
VPORTC at 0x0008 (VPORT)
VREF at 0x00A0
WDT at 0x0100

## Interrupts
1 NMI (CRCSCAN)
2 VLM (BOD)
3 CNT (RTC)
4 PIT (RTC)
5 CCL
6 PORT (PORTA)
7 PORT (PORTB)
8 LUNF (TCA0)
8 OVF (TCA0)
9 HUNF (TCA0)
10 CMP0 (TCA0)
10 LCMP0 (TCA0)
11 CMP1 (TCA0)
11 LCMP1 (TCA0)
12 CMP2 (TCA0)
12 LCMP2 (TCA0)
13 INT (TCB0)
14 TWIS (TWI0)
15 TWIM (TWI0)
16 INT (SPI0)
17 RXC (USART0)
18 DRE (USART0)
19 TXC (USART0)
20 AC (AC0)
21 ERROR (ADC0)
22 RESRDY (ADC0)
23 SAMPRDY (ADC0)
24 PORT (PORTC)
25 INT (TCB1)
26 RXC (USART1)
27 DRE (USART1)
28 TXC (USART1)
29 EE (NVMCTRL)

## Properties
OCD_FEATURES: BREAK_PIN=PA1, BREAK_PIN_ALT=PC4
SIGNATURES: SIGNATURE0=0x1E, SIGNATURE1=0x95, SIGNATURE2=0x26

## Pinouts (pin number, pad)
QFP24: 1 PA2, 2 PA3, 3 GND, 4 VDD, 5 PA4, 6 PA5, 7 PA6, 8 PA7, 9 PB7, 10 PB6, 11 PB5, 12 PB4, 13 PB3, 14 PB2, 15 PB1, 16 PB0, 17 PC0, 18 PC1, 19 PC2, 20 PC3, 21 PC4, 22 PC5, 23 PA0, 24 PA1
