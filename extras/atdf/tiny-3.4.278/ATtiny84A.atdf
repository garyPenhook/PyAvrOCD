# ATtiny84A device description
Architecture: AVR8; Family: tinyAVR
Programming and debug interfaces: ISP, HVSP, debugWIRE
Registers are 8-bit, access not given, no defined reset value unless marked. A register's access mark holds for its fields unless they carry their own. Offsets are from the block's base; lines under a group give offsets from that group; [hi:lo] are bit positions; {n}, {i} and the like mark numbered series; 'fields as' and 'values as' point back to an identical list; <NAME> marks a mode.

## Ordering variants
ATtiny84A-CCU: UFBGA16, pinout BGA_16, up to 20 MHz, -40 to 85 C, 1.8 to 5.5 V
ATtiny84A-MMH: VQFN20, pinout QFN_20, up to 20 MHz, -40 to 85 C, 1.8 to 5.5 V
ATtiny84A-MU: QFN20, pinout QFN_20, up to 20 MHz, -40 to 85 C, 1.8 to 5.5 V
ATtiny84A-PU: PDIP14, pinout SOIC_14, up to 20 MHz, -40 to 85 C, 1.8 to 5.5 V
ATtiny84A-SSU: SOIC14, pinout SOIC_14, up to 20 MHz, -40 to 85 C, 1.8 to 5.5 V
ATtiny84A-SSF: SOIC14, pinout SOIC_14, up to 20 MHz, -40 to 125 C, 1.8 to 5.5 V

## Memory
prog space: start 0x0000 size 0x2000, little endian
  0x0000 FLASH size 0x2000 flash, rw, executable, page 0x40
signatures space: start 0 size 3, little endian
  0 SIGNATURES size 3 signatures, ro
fuses space: start 0 size 0x0003, little endian
  0 FUSES size 0x0003 fuses, rw
lockbits space: start 0 size 0x0001, little endian
  0 LOCKBITS size 0x0001 lockbits, rw
data space: start 0x0000 size 0x0260, little endian
  0x0000 REGISTERS size 0x0020 regs
  0x0020 MAPPED_IO size 0x0040 io
  0x0060 IRAM size 0x0200 ram
eeprom space: start 0x0000 size 0x0200, little endian
  0x0000 EEPROM size 0x0200 eeprom, rw, page 0x04
io space: start 0x00 size 0x40, little endian
osccal space: start 0 size 1, little endian
  0 OSCCAL size 1 osccal, ro

## Peripheral instances (address, pins/pin function, parameters)
PORTA at 0x00 — I/O Port
  pins: P{n} PA{n} (n=0..7)
PORTB at 0x00 — I/O Port
  pins: P0 PB0; P1 PB1; P2 PB2; P3 PB3
AC at 0x00 — Analog Comparator
  pins: AIN0 PA1/ACIN; AIN1 PA2/ACIN
ADC at 0x00 — Analog-to-Digital Converter
  pins: ADC{n} PA{n} (n=0..7); AREF PA0/AREF
USI at 0x00 — Universal Serial Interface
  pins: SCL PA4/TWI; SDA PA6/TWI; USCK PA4/SPI; DO PA5/SPI; DI PA6/SPI
EXINT at 0x00 — External Interrupts
  pins: PCINT{n} PA{n}/EXTINT (n=0..7); PCINT8 PB0/EXTINT; PCINT9 PB1/EXTINT; PCINT10 PB2/EXTINT; PCINT11 PB3/EXTINT; INT0 PB2/EXTINT
EEPROM at 0x00
WDT at 0x00 — Watchdog Timer
TC0 at 0x00 — Timer/Counter, 8-bit
  pins: T0 PA3/T0; OC0B PA7/T0; OC0A PB2/T0
TC1 at 0x00 — Timer/Counter, 16-bit
  pins: T1 PA4/T1; OC1B PA5/T1; OC1A PA6/T1; ICP1 PA7/T1
CPU at 0x00 — CPU Registers
  parameters: CORE_VERSION=V2, NEW_INSTRUCTIONS=lpm rd,z+
BOOT_LOAD at 0x00 — Bootloader
FUSE at 0 in fuses — Fuses
LOCKBIT at 0 in lockbits — Lockbits

## Interrupts
0 RESET — External Pin, Power-on Reset, Brown-out Reset,Watchdog Reset
1 EXT_INT0 — External Interrupt Request 0
2 PCINT0 — Pin Change Interrupt Request 0
3 PCINT1 — Pin Change Interrupt Request 1
4 WDT — Watchdog Time-out
5 TIM1_CAPT — Timer/Counter1 Capture Event
6 TIM1_COMPA — Timer/Counter1 Compare Match A
7 TIM1_COMPB — Timer/Counter1 Compare Match B
8 TIM1_OVF — Timer/Counter1 Overflow
9 TIM0_COMPA — Timer/Counter0 Compare Match A
10 TIM0_COMPB — Timer/Counter0 Compare Match B
11 TIM0_OVF — Timer/Counter0 Overflow
12 ANA_COMP — Analog Comparator
13 ADC — ADC Conversion Complete
14 EE_RDY — EEPROM Ready
15 USI_STR — USI START
16 USI_OVF — USI Overflow

## Properties
SIGNATURES: JTAGID=0x930C, SIGNATURE0=0x1e, SIGNATURE1=0x93, SIGNATURE2=0x0c
OCD: OCD_REVISION=1, OCD_DATAREG=0x27, PROGBASE=0x0000

## Pinouts (pin number, pad)
SOIC_14: 1 VCC, 2 PB0, 3 PB1, 4 PB3, 5 PB2, 6 PA7, 7 PA6, 8 PA5, 9 PA4, 10 PA3, 11 PA2, 12 PA1, 13 PA0, 14 GND
QFN_20: 1 PA4, 2 PA3, 3 PA2, 4 PA1, 5 PA0, 8 GND, 9 VCC, 11 PB0, 12 PB1, 13 PB3, 14 PB2, 15 PA7, 16 PA6, 20 PA5
BGA_16: A2 PA5, A3 PA6, A4 PB2, B1 PA4, B2 PA7, B3 PB1, B4 PB3, C1 PA3, C2 PA2, C3 PA1, C4 PB0, D1 PA0, D2 GND, D3 GND, D4 VCC

## LOCKBIT — Lockbits
Instances: LOCKBIT 0 in lockbits
0x00 LOCKBIT reset 0xFF
  [1:0] LB — Memory Lock
    0=PROG_VER_DISABLED (Further programming and verification disabled); 2=PROG_DISABLED (Further programming disabled); 3=NO_LOCK (No memory lock features enabled)
