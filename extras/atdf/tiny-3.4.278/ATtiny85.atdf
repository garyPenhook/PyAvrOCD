# ATtiny85 device description
Architecture: AVR8; Family: tinyAVR
Programming and debug interfaces: ISP, HVSP, debugWIRE
Registers are 8-bit, access not given, no defined reset value unless marked. A register's access mark holds for its fields unless they carry their own. Offsets are from the block's base; lines under a group give offsets from that group; [hi:lo] are bit positions; {n}, {i} and the like mark numbered series; 'fields as' and 'values as' point back to an identical list; <NAME> marks a mode.

## Ordering variants
ATtiny85V-10PU: PDIP8, pinout SOIC_8, up to 10 MHz, -40 to 85 C, 1.8 to 5.5 V
ATtiny85V-10SU, ATtiny85V-10SH: SOIC8, pinout SOIC_8, up to 10 MHz, -40 to 85 C, 1.8 to 5.5 V
ATtiny85V-10MU: MLF20, pinout QFN_20, up to 10 MHz, -40 to 85 C, 1.8 to 5.5 V
ATtiny85V-20PU: PDIP8, pinout SOIC_8, up to 20 MHz, -40 to 85 C, 2.7 to 5.5 V
ATtiny85V-20SU, ATtiny85V-20SH: SOIC8, pinout SOIC_8, up to 20 MHz, -40 to 85 C, 2.7 to 5.5 V
ATtiny85V-20MU: MLF20, pinout QFN_20, up to 20 MHz, -40 to 85 C, 2.7 to 5.5 V

## Memory
prog space: start 0x0000 size 0x2000, little endian
  0x0000 FLASH size 0x2000 flash, rw, executable, page 0x40
signatures space: start 0 size 3, little endian
  0 SIGNATURES size 3 signatures, ro
fuses space: start 0 size 0x0003, little endian
  0 FUSES size 0x0003 fuses, rw
lockbits space: start 0 size 0x0001, little endian
  0 LOCKBITS size 0x0001 lockbits, rw
data space: start 0x0000 size 0x0260, little endian
  0x0000 REGISTERS size 0x0020 regs
  0x0020 MAPPED_IO size 0x0040 io
  0x0060 IRAM size 0x0200 ram
eeprom space: start 0x0000 size 0x0200, little endian
  0x0000 EEPROM size 0x0200 eeprom, rw, page 0x04
io space: start 0x00 size 0x40, little endian
osccal space: start 0 size 2, little endian
  0 OSCCAL size 2 osccal, ro

## Peripheral instances (address, pins/pin function, parameters)
PORTB at 0x00 — I/O Port
  pins: P0 PB0; P1 PB1; P2 PB2; P3 PB3; P4 PB4; P5 PB5
AC at 0x00 — Analog Comparator
  pins: AIN1 PB1/ACIN; AIN0 PB0/ACIN
ADC at 0x00 — Analog-to-Digital Converter
  pins: ADC0 PB5; ADC1 PB2; ADC2 PB4; AREF PB0/AREF
USI at 0x00 — Universal Serial Interface
  pins: SDA PB0/TWI; SCL PB2/TWI; DI PB0/SPI; DO PB1/SPI; USCK PB2/SPI
EXINT at 0x00 — External Interrupts
  pins: PCINT0 PB0/EXTINT; PCINT1 PB1/EXTINT; PCINT2 PB2/EXTINT; PCINT3 PB3/EXTINT; PCINT4 PB4/EXTINT; PCINT5 PB5/EXTINT; INT0 PB2/EXTINT
EEPROM at 0x00
WDT at 0x00 — Watchdog Timer
TC0 at 0x00 — Timer/Counter, 8-bit
  pins: T0 PB2/T0; OC0B PB1/T0; OC0A PB0/T0
TC1 at 0x00 — Timer/Counter, 16-bit
  pins: OC1B PB4/T1; OC1BINV PB3/T1; OC1A PB1/T1; OC1AINV PB0/T1
BOOT_LOAD at 0x00 — Bootloader
CPU at 0x00 — CPU Registers
  parameters: CORE_VERSION=V2, NEW_INSTRUCTIONS=lpm rd,z+
FUSE at 0 in fuses — Fuses
LOCKBIT at 0 in lockbits — Lockbits

## Interrupts
0 RESET — External Pin, Power-on Reset, Brown-out Reset,Watchdog Reset
1 INT0 — External Interrupt 0
2 PCINT0 — Pin change Interrupt Request 0
3 TIMER1_COMPA — Timer/Counter1 Compare Match 1A
4 TIMER1_OVF — Timer/Counter1 Overflow
5 TIMER0_OVF — Timer/Counter0 Overflow
6 EE_RDY — EEPROM Ready
7 ANA_COMP — Analog comparator
8 ADC — ADC Conversion ready
9 TIMER1_COMPB — Timer/Counter1 Compare Match B
10 TIMER0_COMPA — Timer/Counter0 Compare Match A
11 TIMER0_COMPB — Timer/Counter0 Compare Match B
12 WDT — Watchdog Time-out
13 USI_START
14 USI_OVF — USI Overflow

## Properties
SIGNATURES: JTAGID=0x930B, SIGNATURE0=0x1e, SIGNATURE1=0x93, SIGNATURE2=0x0b
OCD: OCD_REVISION=1, OCD_DATAREG=0x22, PROGBASE=0x0000

## Pinouts (pin number, pad)
SOIC_8: 1 PB5, 2 PB3, 3 PB4, 4 GND, 5 PB0, 6 PB1, 7 PB2, 8 VCC
QFN_20: 1 PB5, 2 PB3, 5 PB4, 8 GND, 11 PB0, 12 PB1, 14 PB2, 15 VCC

## LOCKBIT — Lockbits
Instances: LOCKBIT 0 in lockbits
0x00 LOCKBIT reset 0xFF
  [1:0] LB — Memory Lock
    0=PROG_VER_DISABLED (Further programming and verification disabled); 2=PROG_DISABLED (Further programming disabled); 3=NO_LOCK (No memory lock features enabled)

## PORTB — I/O Port
Instances: PORTB 0x00
0x36 PINB bits used 5:0 — Input Pins, Port B
0x37 DDRB bits used 5:0 — Data Direction Register, Port B
0x38 PORTB bits used 5:0 — Data Register, Port B
