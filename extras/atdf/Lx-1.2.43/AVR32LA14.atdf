# AVR32LA14 device description
Architecture: AVR8X; Family: AVR
Programming and debug interfaces: UPDI
Registers are 8-bit, read-write, reset 0x0 unless marked. A register's access mark holds for its fields unless they carry their own. Offsets are from the block's base; lines under a group give offsets from that group; [hi:lo] are bit positions; {n}, {i} and the like mark numbered series; 'fields as' and 'values as' point back to an identical list; <NAME> marks a mode.

## Ordering variants
AVR32LA14-SOIC/TSSOP: DIP14, up to 20 MHz, -40 to 125 C, 1.62 to 5.5 V

## Memory
data space: start 0x0000 size 0x10000, little endian
  0x00 IO size 0x103F io, rw
  0x1040 LOCKBITS size 0x04 lockbits, rw, page 0x4
  0x1050 FUSES size 0x0C fuses, rw, page 0x8
  0x1080 SIGNATURES size 0x03 signatures, ro, page 0x80
  0x1083 PROD_SIGNATURES size 0x7D signatures, ro, page 0x80
  0x1100 BOOTROW size 0x40 user_signatures, rw, page 0x40
  0x1200 USER_SIGNATURES size 0x40 user_signatures, rw, page 0x40
  0x1400 EEPROM size 0x200 eeprom, rw, page 0x8
  0x7800 INTERNAL_SRAM size 0x800 ram, rw
  0x8000 MAPPED_PROGMEM size 0x8000 other, rw, page 0x40
prog space: start 0x0000 size 0x8000, little endian
  0x00 PROGMEM size 0x8000 flash, rw, executable, page 0x40
  0x00 PROGMEM_NRWW size 0x1000 flash, rw, executable, page 0x40
  0x1000 PROGMEM_RWW size 0x7000 flash, rw, executable, page 0x40

## Peripheral instances (address, pins/pin function, parameters)
AC0 at 0x0680 (AC)
  pins: AINN PD7/AINN2; AINP PD6/AINP3
  pin routing set by: AC0.MUXCTRL.MUXNEG, AC0.MUXCTRL.MUXPOS
ADC0 at 0x0600 (ADC)
  pins: AIN PD4/AIN4 or PD5/AIN5 or PD6/AIN6 or PD7/AIN7
  pin routing set by: ADC0.MUXPOS.MUXPOS
BOD at 0x00A0
BOOTROW at 0x1100
CCL at 0x01C0
  pins: LUT0_IN0 PA0/IN0; LUT0_IN1 PA1/IN1; LUT1_IN0 PC0/IN0; LUT1_IN1 PC1/IN1; LUT1_IN2 PC2/IN2; LUT1_OUT PC3; LUT2_OUT PD6/ALT1
  pin routing set by: CCL.LUT0CTRLB.INSEL0, CCL.LUT0CTRLB.INSEL1, CCL.LUT1CTRLB.INSEL0, CCL.LUT1CTRLB.INSEL1, CCL.LUT1CTRLC.INSEL2, PORTMUX.CCLROUTEA.LUT1, PORTMUX.CCLROUTEA.LUT2
CLKCTRL at 0x0060
  pins: EXTCLK PA0; XTALHF1 PA0; XTALHF2 PA1
CPU at 0x0030
  parameters: CORE_VERSION=V4S
CPUINT at 0x0110
CRCSCAN at 0x0120
EVSYS at 0x0200
  pins: EVOUTC PC2; EVOUTD PD7/ALT1; EVOUTF PF7/ALT1
  pin routing set by: PORTMUX.EVSYSROUTEA.EVOUTC, PORTMUX.EVSYSROUTEA.EVOUTD, PORTMUX.EVSYSROUTEA.EVOUTF
FUSE at 0x1050
GPR at 0x001C
LOCK at 0x1040
NVMCTRL at 0x1000
PORTA at 0x0400 (PORT)
  pins: PIN0 PA0; PIN1 PA1
PORTC at 0x0440 (PORT)
  pins: PIN0 PC0; PIN1 PC1; PIN2 PC2; PIN3 PC3
PORTD at 0x0460 (PORT)
  pins: PIN4 PD4; PIN5 PD5; PIN6 PD6; PIN7 PD7
PORTF at 0x04A0 (PORT)
  pins: PIN6 PF6; PIN7 PF7
PORTMUX at 0x05E0
PTC
  pins: XY0 PA0; XY1 PA1; XY20 PD4; XY21 PD5; XY22 PD6; XY23 PD7; XY39 PF7; XY48 PC0; XY49 PC1; XY50 PC2; XY51 PC3
RSTCTRL at 0x0040
  pins: RESET PF6
RTC at 0x0140
SIGROW at 0x1080
SLPCTRL at 0x0050
SPI0 at 0x0940 (SPI)
  pins: MISO PA1/ALT3 or PD5/ALT4 or PC1/ALT5 or PC2/ALT6; MOSI PA0/ALT3 or PD4/ALT4 or PC0/ALT5 or PC1/ALT6; SCK PC0/ALT3 or PD6/ALT4 or PC2/ALT5 or PC3/ALT6; SS PC1/ALT3 or PD7/ALT4 or PC3/ALT5 or PF7/ALT6
  pin routing set by: PORTMUX.SPIROUTEA.SPI0
SYSCFG at 0x0F00
TCB0 at 0x0B00 (TCB)
TCB1 at 0x0B10 (TCB)
TCE0 at 0x0A00 (TCE)
  pins: WO0 PA0/PORTA or PC0/PORTC or PA0/PORTC2; WO1 PA1/PORTA or PC1/PORTC or PA1/PORTC2; WO2 PC2/PORTC or PC0/PORTC2; WO3 PC3/PORTC or PC1/PORTC2; WO4 PC2/PORTC2 or PD4/PORTD; WO5 PC3/PORTC2 or PD5/PORTD; WO6 PD6/PORTD; WO7 PD7/PORTD
  pin routing set by: PORTMUX.TCEROUTEA.TCE0
TWI0 at 0x0900 (TWI)
  pins: SCL PC3/ALT2 or PA1/ALT3; SDA PC2/ALT2 or PA0/ALT3; SCL_DUAL PC3/ALT3 or PC3; SDA_DUAL PC2/ALT3 or PC2
  pin routing set by: PORTMUX.TWIROUTEA.TWI0
USART0 at 0x0800 (USART)
  pins: AUX0 PD6/ALT3 or PC3/ALT4; AUX1 PD7/ALT3; RXD PD5/ALT3 or PC2/ALT4 or PA1; TXD PD4/ALT3 or PC1/ALT4 or PA0
  pin routing set by: PORTMUX.USARTROUTEA.USART0
USERROW at 0x1200
VPORTA at 0x0000 (VPORT)
VPORTC at 0x0008 (VPORT)
VPORTD at 0x000C (VPORT)
VPORTF at 0x0014 (VPORT)
VREF at 0x00B0
  pins: EXTVREF0 PD7
WDT at 0x0100

## Interrupts
1 NMI (CPU CRCSCAN)
2 VLM (BOD)
3 INT (CRCSCAN)
4 CNT (RTC)
5 PIT (RTC)
6 CCL
7 PORT (PORTA)
8 OVF (TCE0)
9 CMP0 (TCE0)
10 CMP1 (TCE0)
11 CMP2 (TCE0)
12 INT (TCB0)
13 INT (TCB1)
14 TWIS (TWI0)
15 TWIM (TWI0)
16 INT (SPI0)
17 ERROR (USART0)
18 RXC (USART0)
19 DRE (USART0)
20 TXC (USART0)
21 PORT (PORTD)
22 INT (AC0)
23 ERROR (ADC0)
24 RESRDY (ADC0)
25 SAMPRDY (ADC0)
26 PORT (PORTC)
27 PORT (PORTF)
28 NVMREADY (NVMCTRL)

## Properties
SIGNATURES: SIGNATURE0=0x1E, SIGNATURE1=0x95, SIGNATURE2=0x29

## Pinouts (pin number, pad)
DIP14: 1 GND, 2 PF6, 3 PF7, 4 PA0, 5 PA1, 6 PC0, 7 PC1, 8 PC2, 9 PC3, 10 PD4, 11 PD5, 12 PD6, 13 PD7, 14 VDD
